/dts-v1/;

/ {

	__fixups__ {
		accdet = "/fragment@22:target:0";
		audgpio = "/fragment@34:target:0";
		auxadc = "/fragment@16/__overlay__:io-channels:40", "/fragment@41:target:0", "/fragment@42/__overlay__:io-channels:0";
		charger = "/fragment@14:target:0";
		chosen = "/fragment@0:target:0", "/fragment@16/__overlay__:bootmode:0";
		consys = "/fragment@11:target:0";
		dsi_te = "/fragment@64:target:0";
		egis_fp = "/fragment@60:target:0";
		fg_init = "/fragment@16/__overlay__:nvmem-cells:0";
		fg_soc = "/fragment@16/__overlay__:nvmem-cells:4";
		flashlights_riod = "/fragment@81:target:0";
		goodix_fp = "/fragment@26:target:0";
		gpio = "/fragment@55:target:0";
		gpio_usage_mapping = "/fragment@54:target:0";
		i2c0 = "/fragment@44:target:0";
		i2c1 = "/fragment@45:target:0";
		i2c2 = "/fragment@46:target:0";
		i2c3 = "/fragment@2:target:0", "/fragment@47:target:0";
		i2c4 = "/fragment@48:target:0";
		i2c5 = "/fragment@7:target:0", "/fragment@49:target:0";
		i2c6 = "/fragment@6:target:0", "/fragment@9:target:0", "/fragment@50:target:0";
		i2c7 = "/fragment@51:target:0";
		i2c8 = "/fragment@52:target:0";
		i2c9 = "/fragment@53:target:0";
		irq_nfc = "/fragment@59:target:0";
		irtx_pwm = "/fragment@32:target:0";
		kd_camera_hw1 = "/fragment@75:target:0", "/fragment@79:target:0";
		keypad = "/fragment@12:target:0", "/fragment@77:target:0";
		main_pmic = "/fragment@21:target:0", "/fragment@66:target:0";
		md1_sim1_hot_plug_eint = "/fragment@67:target:0";
		md1_sim2_hot_plug_eint = "/fragment@68:target:0";
		md_auxadc = "/fragment@42:target:0";
		mrdump_ext_rst = "/fragment@58:target:0";
		msdc1_ins = "/fragment@57:target:0";
		mt6370_chg = "/fragment@16/__overlay__:charger:0", "/fragment@38:target:0";
		mt6370_pmu = "/fragment@36:target:0";
		mt6370_typec = "/fragment@37:target:0";
		mt_pmic_vcama_ldo_reg = "/fragment@69:target:0", "/fragment@75/__overlay__:vcama-supply:0", "/fragment@79/__overlay__:cam0_vcama-supply:0", "/fragment@79/__overlay__:cam1_vcama-supply:0", "/fragment@79/__overlay__:cam2_vcama-supply:0";
		mt_pmic_vcamd_ldo_reg = "/fragment@72:target:0", "/fragment@75/__overlay__:vcamd_main2-supply:0", "/fragment@79/__overlay__:cam0_vcamd-supply:0", "/fragment@79/__overlay__:cam1_vcamd-supply:0", "/fragment@79/__overlay__:cam2_vcamd-supply:0";
		mt_pmic_vcamio_ldo_reg = "/fragment@73:target:0", "/fragment@75/__overlay__:vcamio-supply:0", "/fragment@75/__overlay__:vcamio_sub-supply:0", "/fragment@75/__overlay__:vcamio_main2-supply:0", "/fragment@79/__overlay__:cam0_vcamio-supply:0", "/fragment@79/__overlay__:cam1_vcamio-supply:0", "/fragment@79/__overlay__:cam2_vcamio-supply:0", "/fragment@79/__overlay__:cam3_vcamio-supply:0";
		mt_pmic_vldo28_ldo_reg = "/fragment@74:target:0", "/fragment@75/__overlay__:vcamaf-supply:0", "/fragment@75/__overlay__:vcamaf_sub-supply:0", "/fragment@75/__overlay__:vcamaf_main2-supply:0", "/fragment@76/__overlay__:vtouch-supply:0", "/fragment@79/__overlay__:cam0_vcamaf-supply:0";
		mt_pmic_vsim1_ldo_reg = "/fragment@70:target:0";
		mt_pmic_vsim2_ldo_reg = "/fragment@71:target:0";
		mtk_gauge = "/fragment@16:target:0";
		mtkfb = "/fragment@5:target:0";
		odm = "/fragment@1:target:0";
		oplus_fp_common = "/fragment@31:target:0";
		otg_iddig = "/fragment@17:target:0", "/fragment@63:target:0";
		pio = "/fragment@1/__overlay__/oppo_devinfo:aboard-gpio0:0", "/fragment@1/__overlay__/kpd_volume_down:interrupt-parent:0", "/fragment@1/__overlay__/oplus_sim_detect:Hw,sim_det:0", "/fragment@2/__overlay__/nfc_nxp@28:nxp,pn544-irq:0", "/fragment@2/__overlay__/nfc_nxp@28:nxp,pn544-ven:0", "/fragment@2/__overlay__/nfc_nxp@28:nxp,pn544-fw-dwnld:0", "/fragment@2/__overlay__/nfc_nxp@28:interrupt-parent:0", "/fragment@4:target:0", "/fragment@7/__overlay__/bq25601@6B:interrupt-parent:0", "/fragment@7/__overlay__/rt-swchg@53:rt,intr_gpio:0", "/fragment@8:target:0", "/fragment@10:target:0", "/fragment@12/__overlay__:keypad,volume-down:0", "/fragment@13:target:0", "/fragment@15:target:0", "/fragment@17/__overlay__:interrupt-parent:0", "/fragment@18:target:0", "/fragment@20:target:0", "/fragment@23:target:0", "/fragment@24/__overlay__/finger_spi@0:goodix,pw_en:0", "/fragment@25:target:0", "/fragment@26/__overlay__:interrupt-parent:0", "/fragment@26/__overlay__:goodix,gpio_irq:0", "/fragment@26/__overlay__:goodix,gpio_reset:0", "/fragment@26/__overlay__:goodix,gpio_cs:0", "/fragment@27:target:0", "/fragment@28/__overlay__:sil,silead_irq:0", "/fragment@29:target:0", "/fragment@30:target:0", "/fragment@31/__overlay__:oplus,fp_gpio_0:0", "/fragment@31/__overlay__:oplus,fp_gpio_1:0", "/fragment@33:target:0", "/fragment@35:target:0", "/fragment@36/__overlay__:mt6370,intr_gpio:0", "/fragment@37/__overlay__:mt6370pd,intr_gpio:0", "/fragment@39/__overlay__/touchscreen@0:reset-gpio:0", "/fragment@39/__overlay__/touchscreen@0:interrupt-parent:0", "/fragment@39/__overlay__/touchscreen@0:irq-gpio:0", "/fragment@40:target:0", "/fragment@54/__overlay__:GPIO_SIM2_SIO:0", "/fragment@54/__overlay__:GPIO_SIM2_SRST:0", "/fragment@54/__overlay__:GPIO_SIM2_SCLK:0", "/fragment@54/__overlay__:GPIO_SIM1_SCLK:0", "/fragment@54/__overlay__:GPIO_SIM1_SRST:0", "/fragment@54/__overlay__:GPIO_SIM1_SIO:0", "/fragment@54/__overlay__:GPIO_SIM2_HOT_PLUG:0", "/fragment@54/__overlay__:GPIO_SIM1_HOT_PLUG:0", "/fragment@54/__overlay__:GPIO_FDD_BAND_SUPPORT_DETECT_3RD_PIN:0", "/fragment@54/__overlay__:GPIO_FDD_BAND_SUPPORT_DETECT_4TH_PIN:0", "/fragment@54/__overlay__:GPIO_FDD_BAND_SUPPORT_DETECT_1ST_PIN:0", "/fragment@54/__overlay__:GPIO_FDD_BAND_SUPPORT_DETECT_2ND_PIN:0", "/fragment@56/__overlay__:interrupt-parent:0", "/fragment@57/__overlay__:interrupt-parent:0", "/fragment@58/__overlay__:interrupt-parent:0", "/fragment@58/__overlay__:deb-gpios:0", "/fragment@59/__overlay__:interrupt-parent:0", "/fragment@60/__overlay__:interrupt-parent:0", "/fragment@61/__overlay__:interrupt-parent:0", "/fragment@62/__overlay__:interrupt-parent:0", "/fragment@63/__overlay__:interrupt-parent:0", "/fragment@64/__overlay__:interrupt-parent:0", "/fragment@65/__overlay__:interrupt-parent:0", "/fragment@65/__overlay__:deb-gpios:0", "/fragment@66/__overlay__:interrupt-parent:0", "/fragment@78:target:0", "/fragment@80:target:0";
		pmic_auxadc = "/fragment@16/__overlay__:io-channels:0", "/fragment@16/__overlay__:io-channels:8", "/fragment@16/__overlay__:io-channels:16", "/fragment@16/__overlay__:io-channels:24", "/fragment@16/__overlay__:io-channels:32";
		pmic_clock_buffer_ctrl = "/fragment@43:target:0";
		rt9465_slave_chr = "/fragment@62:target:0";
		silead_fp = "/fragment@28:target:0";
		spi1 = "/fragment@24:target:0";
		spi2 = "/fragment@39:target:0";
		subpmic_pmu_eint = "/fragment@61:target:0";
		swtp = "/fragment@3:target:0", "/fragment@65:target:0";
		touch = "/fragment@56:target:0", "/fragment@76:target:0";
		uart0 = "/fragment@19:target:0";
	};

	__local_fixups__ {

		fragment@1 {

			__overlay__ {

				oppo_devinfo {
					pinctrl-0 = <0x0>;
					pinctrl-1 = <0x0>;
					pinctrl-2 = <0x0>;
				};
			};
		};

		fragment@11 {

			__overlay__ {
				pinctrl-0 = <0x0>;
				pinctrl-1 = <0x0>;
				pinctrl-2 = <0x0>;
				pinctrl-3 = <0x0>;
			};
		};

		fragment@12 {

			__overlay__ {
				pinctrl-0 = <0x0>;
				pinctrl-1 = <0x0>;
			};
		};

		fragment@17 {

			__overlay__ {
				pinctrl-0 = <0x0>;
				pinctrl-1 = <0x0>;
			};
		};

		fragment@19 {

			__overlay__ {
				pinctrl-0 = <0x0>;
				pinctrl-1 = <0x0>;
			};
		};

		fragment@22 {

			__overlay__ {
				pinctrl-0 = <0x0>;
				pinctrl-1 = <0x0>;
			};
		};

		fragment@26 {

			__overlay__ {
				pinctrl-0 = <0x0>;
				pinctrl-1 = <0x0>;
				pinctrl-2 = <0x0>;
				pinctrl-3 = <0x0>;
			};
		};

		fragment@28 {

			__overlay__ {
				pinctrl-0 = <0x0>;
				pinctrl-1 = <0x0>;
				pinctrl-2 = <0x0>;
				pinctrl-3 = <0x0>;
				pinctrl-4 = <0x0>;
				pinctrl-5 = <0x0>;
				pinctrl-6 = <0x0>;
				pinctrl-7 = <0x0>;
			};
		};

		fragment@31 {

			__overlay__ {
				pinctrl-0 = <0x0>;
				pinctrl-1 = <0x0>;
				pinctrl-2 = <0x0>;
				pinctrl-3 = <0x0>;
				pinctrl-4 = <0x0>;
				pinctrl-5 = <0x0>;
			};
		};

		fragment@32 {

			__overlay__ {
				pinctrl-0 = <0x0>;
				pinctrl-1 = <0x0>;
			};
		};

		fragment@34 {

			__overlay__ {
				pinctrl-0 = <0x0>;
				pinctrl-1 = <0x0>;
				pinctrl-2 = <0x0>;
				pinctrl-3 = <0x0>;
				pinctrl-4 = <0x0>;
				pinctrl-5 = <0x0>;
				pinctrl-6 = <0x0>;
				pinctrl-7 = <0x0>;
				pinctrl-8 = <0x0>;
				pinctrl-9 = <0x0>;
			};
		};

		fragment@39 {

			__overlay__ {

				touchscreen@0 {
					pinctrl-0 = <0x0>;
				};
			};
		};

		fragment@5 {

			__overlay__ {
				pinctrl-0 = <0x0>;
				pinctrl-1 = <0x0>;
				pinctrl-2 = <0x0>;
				pinctrl-3 = <0x0>;
				pinctrl-4 = <0x0>;
				pinctrl-5 = <0x0>;
			};
		};

		fragment@7 {

			__overlay__ {

				bq25601@6B {
					pinctrl-0 = <0x0>;
					pinctrl-1 = <0x0>;
				};
			};
		};

		fragment@79 {

			__overlay__ {
				pinctrl-0 = <0x0>;
				pinctrl-1 = <0x0>;
				pinctrl-10 = <0x0>;
				pinctrl-11 = <0x0>;
				pinctrl-12 = <0x0>;
				pinctrl-13 = <0x0>;
				pinctrl-14 = <0x0>;
				pinctrl-15 = <0x0>;
				pinctrl-16 = <0x0>;
				pinctrl-17 = <0x0>;
				pinctrl-18 = <0x0>;
				pinctrl-19 = <0x0>;
				pinctrl-2 = <0x0>;
				pinctrl-20 = <0x0>;
				pinctrl-21 = <0x0>;
				pinctrl-22 = <0x0>;
				pinctrl-3 = <0x0>;
				pinctrl-4 = <0x0>;
				pinctrl-5 = <0x0>;
				pinctrl-6 = <0x0>;
				pinctrl-7 = <0x0>;
				pinctrl-8 = <0x0>;
				pinctrl-9 = <0x0>;
			};
		};

		fragment@81 {

			__overlay__ {
				pinctrl-0 = <0x0>;
				pinctrl-1 = <0x0>;
				pinctrl-2 = <0x0>;
				pinctrl-3 = <0x0>;
				pinctrl-4 = <0x0>;
				pinctrl-5 = <0x0>;
			};
		};
	};

	__symbols__ {
		aboard_pin_gpio0_active = "/fragment@15/__overlay__/active@id0";
		aboard_pin_gpio0_sleep = "/fragment@15/__overlay__/sleep@id0";
		accdet_pins_default = "/fragment@23/__overlay__/accdetdefault";
		accdet_pins_eint_as_int = "/fragment@23/__overlay__/accdeteint@0";
		alsps_arch = "/fragment@1/__overlay__/alsps_arch";
		aud_clk_miso_off = "/fragment@35/__overlay__/aud_clk_miso_off";
		aud_clk_miso_on = "/fragment@35/__overlay__/aud_clk_miso_on";
		aud_clk_mosi_off = "/fragment@35/__overlay__/aud_clk_mosi_off";
		aud_clk_mosi_on = "/fragment@35/__overlay__/aud_clk_mosi_on";
		aud_dat_miso_off = "/fragment@35/__overlay__/aud_dat_miso_off";
		aud_dat_miso_on = "/fragment@35/__overlay__/aud_dat_miso_on";
		aud_dat_mosi_off = "/fragment@35/__overlay__/aud_dat_mosi_off";
		aud_dat_mosi_on = "/fragment@35/__overlay__/aud_dat_mosi_on";
		aud_pins_extamp_pullhigh = "/fragment@35/__overlay__/aud_pins_extamp_pullhigh";
		aud_pins_extamp_pulllow = "/fragment@35/__overlay__/aud_pins_extamp_pulllow";
		camera0_mclk_off = "/fragment@78/__overlay__/camera0_mclk_gpio_mode@gpio99";
		camera0_mclk_on = "/fragment@78/__overlay__/camera0_mclk_2ma@gpio99";
		camera0_rst_high = "/fragment@78/__overlay__/camera0_rst_output_high@gpio101";
		camera0_rst_low = "/fragment@78/__overlay__/camera0_rst_output_low@gpio101";
		camera0_vcama_off = "/fragment@78/__overlay__/camera0_vcama_off@gpio156";
		camera0_vcama_on = "/fragment@78/__overlay__/camera0_vcama_on@gpio156";
		camera1_mclk_off = "/fragment@78/__overlay__/camera1_mclk_gpio_mode@gpio100";
		camera1_mclk_on = "/fragment@78/__overlay__/camera1_mclk_2ma@gpio100";
		camera1_rst_high = "/fragment@78/__overlay__/camera1_rst_output_high@gpio102";
		camera1_rst_low = "/fragment@78/__overlay__/camera1_rst_output_low@gpio102";
		camera1_vcama_off = "/fragment@78/__overlay__/camera1_vcama_off@gpio155";
		camera1_vcama_on = "/fragment@78/__overlay__/camera1_vcama_on@gpio155";
		camera2_mclk_off = "/fragment@78/__overlay__/camera2_mclk_gpio_mode@gpio108";
		camera2_mclk_on = "/fragment@78/__overlay__/camera2_mclk_2ma@gpio108";
		camera2_pnd_high = "/fragment@78/__overlay__/camera2_pnd_output_high@gpio107";
		camera2_pnd_low = "/fragment@78/__overlay__/camera2_pnd_output_low@gpio107";
		camera3_mclk_off = "/fragment@78/__overlay__/camera3_mclk_gpio_mode@gpio88";
		camera3_mclk_on = "/fragment@78/__overlay__/camera3_mclk_2ma@gpio88";
		camera3_rst_high = "/fragment@78/__overlay__/camera3_rst_output_high@gpio160";
		camera3_rst_low = "/fragment@78/__overlay__/camera3_rst_output_low@gpio160";
		camera3_vcama_off = "/fragment@78/__overlay__/camera3_vcama_off@gpio156";
		camera3_vcama_on = "/fragment@78/__overlay__/camera3_vcama_on@gpio156";
		camera_main_af_mtk = "/fragment@46/__overlay__/camera_main_af@0c";
		camera_main_eeprom_mtk = "/fragment@46/__overlay__/camera_main_eeprom@50";
		camera_main_mtk = "/fragment@46/__overlay__/camera_main@1a";
		camera_pins_default = "/fragment@78/__overlay__/camdefault";
		camera_sub_eeprom_mtk = "/fragment@48/__overlay__/camera_sub_eeprom@52";
		camera_sub_mtk = "/fragment@48/__overlay__/camera_sub@2d";
		consys_pins_default = "/fragment@10/__overlay__/consys_default";
		ctp_ts_spi_mode = "/fragment@40/__overlay__/ctp_ts_spi_mode";
		ext_buck_lp4_mtk = "/fragment@50/__overlay__/ext_buck_lp4@57";
		ext_buck_lp4x_mtk = "/fragment@50/__overlay__/ext_buck_lp4x@50";
		ext_buck_vgpu_mtk = "/fragment@50/__overlay__/ext_buck_vgpu@55";
		fingerfp_power18_high = "/fragment@27/__overlay__/state_power18_high";
		fingerfp_power18_low = "/fragment@27/__overlay__/state_power18_low";
		fingerfp_power_high = "/fragment@27/__overlay__/state_power_high";
		fingerfp_power_low = "/fragment@27/__overlay__/state_power_low";
		flashlight_pins_default = "/fragment@80/__overlay__/flashlight_pins_default";
		flashlight_pins_srobe_off = "/fragment@80/__overlay__/flashlight_pins_srobe_off";
		flashlight_pins_srobe_on = "/fragment@80/__overlay__/flashlight_pins_srobe_on";
		flashlight_pins_torch_off = "/fragment@80/__overlay__/flashlight_pins_torch_off";
		flashlight_pins_torch_on = "/fragment@80/__overlay__/flashlight_pins_torch_on";
		flashlight_pins_torch_pwm = "/fragment@80/__overlay__/flashlight_pins_torch_pwm";
		goodix_irq_no_pull = "/fragment@25/__overlay__/goodix_irq_no_pull";
		goodix_irq_out_low = "/fragment@25/__overlay__/goodix_irq_out_low";
		goodix_power_cs = "/fragment@25/__overlay__/goodix_power_cs";
		goodix_reset_default = "/fragment@25/__overlay__/goodix_reset_default";
		gpio_id0_default = "/fragment@29/__overlay__/gpio_id0_default";
		gpio_id0_pull_down = "/fragment@29/__overlay__/gpio_id0_pull_down";
		gpio_id0_pull_up = "/fragment@29/__overlay__/gpio_id0_pull_up";
		gpio_id1_default = "/fragment@30/__overlay__/gpio_id1_default";
		gpio_id1_pull_down = "/fragment@30/__overlay__/gpio_id1_pull_down";
		gpio_id1_pull_up = "/fragment@30/__overlay__/gpio_id1_pull_up";
		gpslna_pins_init = "/fragment@10/__overlay__/gpslna@0";
		gpslna_pins_oh = "/fragment@10/__overlay__/gpslna@1";
		gpslna_pins_ol = "/fragment@10/__overlay__/gpslna@2";
		gsensor_1 = "/fragment@1/__overlay__/gsensor_1";
		gsensor_2 = "/fragment@1/__overlay__/gsensor_2";
		gsensor_3 = "/fragment@1/__overlay__/gsensor_3";
		hw_pins_default = "/fragment@15/__overlay__/default@hw_sub_id";
		irq_default = "/fragment@8/__overlay__/irq_default@gpio11";
		irq_set_low = "/fragment@8/__overlay__/irq_set_low@gpio11";
		irtx_gpio_led_default = "/fragment@33/__overlay__/irtx_gpio_led_def@gpio90";
		irtx_gpio_led_set = "/fragment@33/__overlay__/irtx_gpio_led_set@gpio90";
		kpd_pins_default = "/fragment@13/__overlay__/kpdgpiodefault";
		kpd_volume_down = "/fragment@1/__overlay__/kpd_volume_down";
		led0 = "/fragment@1/__overlay__/led@0";
		led1 = "/fragment@1/__overlay__/led@1";
		led2 = "/fragment@1/__overlay__/led@2";
		led3 = "/fragment@1/__overlay__/led@3";
		led4 = "/fragment@1/__overlay__/led@4";
		led5 = "/fragment@1/__overlay__/led@5";
		led6 = "/fragment@1/__overlay__/led@6";
		lux_aod = "/fragment@1/__overlay__/lux_aod";
		msensor_1 = "/fragment@1/__overlay__/msensor_1";
		msensor_2 = "/fragment@1/__overlay__/msensor_2";
		msensor_3 = "/fragment@1/__overlay__/msensor_3";
		mtk_cali = "/fragment@1/__overlay__/mtk_cali";
		mtkfb_pins_lcd_bias_enn0 = "/fragment@4/__overlay__/lcd_bias_enn0_gpio";
		mtkfb_pins_lcd_bias_enn1 = "/fragment@4/__overlay__/lcd_bias_enn1_gpio";
		mtkfb_pins_lcd_bias_enp0 = "/fragment@4/__overlay__/lcd_bias_enp0_gpio";
		mtkfb_pins_lcd_bias_enp1 = "/fragment@4/__overlay__/lcd_bias_enp1_gpio";
		mtkfb_pins_lcm_rst_out0_gpio = "/fragment@4/__overlay__/lcm_rst_out0_gpio";
		mtkfb_pins_lcm_rst_out1_gpio = "/fragment@4/__overlay__/lcm_rst_out1_gpio";
		nfc_chipset = "/fragment@1/__overlay__/nfc_chipset";
		oplus_project = "/fragment@1/__overlay__/oplus_project";
		oppo_devinfo = "/fragment@1/__overlay__/oppo_devinfo";
		otg_gpio_low = "/fragment@18/__overlay__/otg_gpio_low";
		otg_iddg_high = "/fragment@18/__overlay__/otg_iddg_high";
		pick_up = "/fragment@1/__overlay__/pick_up";
		pmic_accdet = "/fragment@21/__overlay__/pmic_accdet";
		silfp_default = "/fragment@27/__overlay__/silfpdefault";
		silfp_irq = "/fragment@27/__overlay__/fp_eint@8";
		silfp_rst_high = "/fragment@27/__overlay__/state_reset_high";
		silfp_rst_low = "/fragment@27/__overlay__/state_reset_low";
		slave_charger_mtk = "/fragment@47/__overlay__/slave_charger@4b";
		speaker_amp_mtk = "/fragment@47/__overlay__/speaker_amp@34";
		subpmic_pmu_mtk = "/fragment@49/__overlay__/subpmic_pmu@34";
		uart0_rx_gpio_input = "/fragment@20/__overlay__/uart0_rx_gpio@gpio95";
		uart0_tx_gpio_input = "/fragment@20/__overlay__/uart0_tx_gpio@gpio96";
		usb_type_c_mtk = "/fragment@49/__overlay__/usb_type_c@4e";
		vibrator0 = "/fragment@1/__overlay__/vibrator@0";
		volume_down_gpio_eint = "/fragment@13/__overlay__/volume_down@0";
	};

	fragment@0 {
		target = <0xffffffff>;

		__overlay__ {
			atag,videolfb-fb_base_h = <0x0>;
			atag,videolfb-fb_base_l = "^`P";
			atag,videolfb-fps = <0x1770>;
			atag,videolfb-islcm_inited = <0x0>;
			atag,videolfb-islcmfound = <0x1>;
			atag,videolfb-lcmname = "nt35695B_fhd_dsi_cmd_auo_rt5081_drv";
			atag,videolfb-vramSize = <0x17bb000>;
		};
	};

	fragment@1 {
		target = <0xffffffff>;

		__overlay__ {

			alsps_arch {
				new-arch-supported = <0x0>;
				phandle = <0x63>;
				status = "okay";
			};

			gsensor_1 {
				config_miso = <0x1>;
				correct_y_bias = <0x1>;
				direction = <0x3>;
				eint_num = <0xc>;
				i2c_addr = <0x12>;
				i2c_num = <0x0>;
				phandle = <0x5b>;
				sensor_name = <0x7>;
				status = "okay";
				step_count_7_en = <0x1>;
			};

			gsensor_2 {
				config_miso = <0x1>;
				correct_y_bias = <0x1>;
				direction = <0x3>;
				eint_num = <0xc>;
				i2c_addr = <0x18>;
				i2c_num = <0x0>;
				phandle = <0x5c>;
				sensor_name = <0xa>;
				status = "okay";
				step_count_7_en = <0x1>;
			};

			gsensor_3 {
				config_miso = <0x1>;
				correct_y_bias = <0x1>;
				direction = <0x3>;
				eint_num = <0xc>;
				i2c_addr = <0x18>;
				i2c_num = <0x0>;
				phandle = <0x5d>;
				sensor_name = <0xb>;
				status = "okay";
				step_count_7_en = <0x1>;
			};

			kpd_volume_down {
				compatible = "mediatek, VOLUME_DOWN-eint";
				debounce = <0x7d00>;
				interrupt-parent = <0xffffffff>;
				interrupts = <0x5e 0x2 0x5e 0x0>;
				phandle = <0x68>;
				status = "okay";
			};

			led@0 {
				compatible = "mediatek,red";
				data = <0x1>;
				led_mode = <0x0>;
				phandle = <0x54>;
				pwm_config = <0x0 0x0 0x0 0x0 0x0>;
			};

			led@1 {
				compatible = "mediatek,green";
				data = <0x1>;
				led_mode = <0x0>;
				phandle = <0x55>;
				pwm_config = <0x0 0x0 0x0 0x0 0x0>;
			};

			led@2 {
				compatible = "mediatek,blue";
				data = <0x1>;
				led_mode = <0x0>;
				phandle = <0x56>;
				pwm_config = <0x0 0x0 0x0 0x0 0x0>;
			};

			led@3 {
				compatible = "mediatek,jogball-backlight";
				data = <0x1>;
				led_mode = <0x0>;
				phandle = <0x57>;
				pwm_config = <0x0 0x0 0x0 0x0 0x0>;
			};

			led@4 {
				compatible = "mediatek,keyboard-backlight";
				data = <0x1>;
				led_mode = <0x0>;
				phandle = <0x58>;
				pwm_config = <0x0 0x0 0x0 0x0 0x0>;
			};

			led@5 {
				compatible = "mediatek,button-backlight";
				data = <0x1>;
				led_mode = <0x0>;
				phandle = <0x59>;
				pwm_config = <0x0 0x0 0x0 0x0 0x0>;
			};

			led@6 {
				compatible = "mediatek,lcd-backlight";
				data = <0x1>;
				led_mode = <0x4>;
				phandle = <0x5a>;
				pwm_config = <0x0 0x3 0x0 0x0 0x0>;
			};

			lux_aod {
				phandle = <0x62>;
				status = "okay";
				use-proximity = <0x1>;
			};

			msensor_1 {
				direction = <0x3>;
				eint_num = <0x0>;
				i2c_addr = <0xc>;
				i2c_num = <0x0>;
				phandle = <0x5e>;
				sensor_name = <0x0>;
				status = "okay";
			};

			msensor_2 {
				direction = <0x3>;
				eint_num = <0x0>;
				i2c_addr = <0x30>;
				i2c_num = <0x0>;
				phandle = <0x5f>;
				sensor_name = <0x2>;
				status = "okay";
			};

			msensor_3 {
				direction = <0x4>;
				eint_num = <0x0>;
				i2c_addr = <0xc>;
				i2c_num = <0x0>;
				phandle = <0x60>;
				sensor_name = <0x5>;
				status = "okay";
			};

			mtk_cali {
				mtk-cali-supported = <0x1>;
				phandle = <0x64>;
				status = "okay";
			};

			nfc_chipset {
				chipset-20701-182 = "PN557";
				chipset-20701-183 = "PN557";
				compatible = "oppo-nfc-chipset";
				phandle = <0x69>;
			};

			oplus_project {
				compatible = "oppo,oplus_project";
				phandle = <0x65>;
			};

			oplus_sim_detect {
				Hw,sim_det = <0xffffffff 0x2f 0x0>;
				compatible = "oplus, sim_detect";
			};

			oppo_devinfo {
				aboard-gpio0 = <0xffffffff 0x2b 0x0>;
				compatible = "oppo-devinfo";
				phandle = <0x66>;
				pinctrl-0 = <0x1>;
				pinctrl-1 = <0x2>;
				pinctrl-2 = <0x3>;
				pinctrl-names = "default", "aboard_gpio0_sleep", "aboard_gpio0_active";

				main-sub {
					aboard-patterns = <0x0>;
					compatible = "hw-match, main-sub";
					match-projects = <0x50dd>;
				};
			};

			pick_up {
				phandle = <0x61>;
				status = "okay";
				use-proximity = <0x1>;
			};

			vibrator@0 {
				compatible = "mediatek,vibrator";
				phandle = <0x67>;
				vib_limit = <0x9>;
				vib_timer = <0x19>;
				vib_vol = <0x9>;
			};
		};
	};

	fragment@10 {
		target = <0xffffffff>;

		__overlay__ {

			consys_default {
				phandle = <0xc>;
			};

			gpslna@0 {
				phandle = <0xd>;

				pins_cmd_dat {
					bias-disable;
					output-low;
					pinmux = <0x5b00>;
					slew-rate = <0x0>;
				};
			};

			gpslna@1 {
				phandle = <0xe>;

				pins_cmd_dat {
					output-high;
					pinmux = <0x5b00>;
					slew-rate = <0x1>;
				};
			};

			gpslna@2 {
				phandle = <0xf>;

				pins_cmd_dat {
					output-low;
					pinmux = <0x5b00>;
					slew-rate = <0x1>;
				};
			};
		};
	};

	fragment@11 {
		target = <0xffffffff>;

		__overlay__ {
			pinctrl-0 = <0xc>;
			pinctrl-1 = <0xd>;
			pinctrl-2 = <0xe>;
			pinctrl-3 = <0xf>;
			pinctrl-names = "default", "gps_lna_state_init", "gps_lna_state_oh", "gps_lna_state_ol";
			status = "okay";
		};
	};

	fragment@12 {
		target = <0xffffffff>;

		__overlay__ {
			keypad,volume-down = <0xffffffff 0x5e 0x0>;
			pinctrl-0 = <0x10>;
			pinctrl-1 = <0x11>;
			pinctrl-names = "default", "volume_down_as_int";
			status = "okay";
		};
	};

	fragment@13 {
		target = <0xffffffff>;

		__overlay__ {

			kpdgpiodefault {
				phandle = <0x10>;

				pins_cmd_dat {
					bias-pull-up = <0x66>;
					input-schmitt-enable;
					output-low;
					pinmux = <0x5d01>;
				};
			};

			volume_down@0 {
				phandle = <0x11>;

				pins_cmd_dat {
					input-enable;
					pinmux = <0x5e00>;
					slew-rate = <0x0>;
				};
			};
		};
	};

	fragment@14 {
		target = <0xffffffff>;

		__overlay__ {
			compatible = "mediatek,charger";
			qcom,batt_capacity_mah = <0x1388>;
			qcom,charger_hv_thr = <0x16a8>;
			qcom,charger_lv_thr = <0xd48>;
			qcom,charger_recv_thr = <0x16a8>;
			qcom,check_batt_full_by_sw;
			qcom,chg_ctrl_by_calling;
			qcom,chg_ctrl_by_camera;
			qcom,chg_ctrl_by_lcd;
			qcom,cold_bat_decidegc = <0x14>;
			qcom,cold_vfloat_over_sw_limit = <0xfa0>;
			qcom,cold_vfloat_sw_limit = <0xf5a>;
			qcom,cool_bat_decidegc = <0x32>;
			qcom,cool_vfloat_over_sw_limit = <0x1162>;
			qcom,cool_vfloat_over_sw_limit_2nd = <0x112b>;
			qcom,cool_vfloat_sw_limit = <0x111c>;
			qcom,default_iterm_ma = <0x109>;
			qcom,default_iterm_ma_2nd = <0x12c>;
			qcom,default_normal_vfloat_over_sw_limit = <0x1162>;
			qcom,default_normal_vfloat_over_sw_limit_2nd = <0x112b>;
			qcom,default_normal_vfloat_sw_limit = <0x111c>;
			qcom,default_temp_normal_fastchg_current_ma = <0x898>;
			qcom,default_temp_normal_vfloat_mv = <0x1153>;
			qcom,default_temp_normal_vfloat_mv_2nd = <0x1127>;
			qcom,dual_charger_support = <0x1>;
			qcom,ff1_exit_step_ma = <0x1e8>;
			qcom,ff1_normal_fastchg_ma = <0x440>;
			qcom,ff1_warm_exit_step_ma = <0x1a2>;
			qcom,ffc2_exit_step_ma = <0xb4>;
			qcom,ffc2_normal_fastchg_ma = <0x30c>;
			qcom,ffc2_temp_high_decidegc = <0x190>;
			qcom,ffc2_temp_low_decidegc = <0x78>;
			qcom,ffc2_temp_warm_decidegc = <0x15e>;
			qcom,ffc2_warm_exit_step_ma = <0xaa>;
			qcom,ffc2_warm_fastchg_ma = <0x348>;
			qcom,ffc_normal_vfloat_over_sw_limit = <0x1194>;
			qcom,ffc_normal_vfloat_sw_limit = <0x114e>;
			qcom,ffc_temp_normal_vfloat_mv = <0x1194>;
			qcom,hot_bat_decidegc = <0x212>;
			qcom,input_current_calling_ma = <0x4b0>;
			qcom,input_current_camera_ma = <0x4b0>;
			qcom,input_current_cdp_ma = <0x5dc>;
			qcom,input_current_charger_ma = <0x7d0>;
			qcom,input_current_led_ma = <0x4b0>;
			qcom,input_current_led_ma_forcmcc = <0x1f4>;
			qcom,input_current_led_ma_high = <0x3e8>;
			qcom,input_current_led_ma_normal = <0x7d0>;
			qcom,input_current_led_ma_warm = <0x5dc>;
			qcom,input_current_usb_ma = <0x1f4>;
			qcom,iterm_disabled = <0x0>;
			qcom,iterm_ma = <0x131>;
			qcom,iterm_ma_2nd = <0x12c>;
			qcom,led_high_bat_decidegc = <0x172>;
			qcom,led_warm_bat_decidegc = <0x15e>;
			qcom,little_cold_bat_decidegc = <0x0>;
			qcom,little_cold_vfloat_over_sw_limit = <0x1162>;
			qcom,little_cold_vfloat_over_sw_limit_2nd = <0x112b>;
			qcom,little_cold_vfloat_sw_limit = <0x111c>;
			qcom,little_cool_bat_decidegc = <0x78>;
			qcom,little_cool_vfloat_over_sw_limit = <0x1162>;
			qcom,little_cool_vfloat_over_sw_limit_2nd = <0x112b>;
			qcom,little_cool_vfloat_sw_limit = <0x111c>;
			qcom,max_chg_time_sec = <0xea60>;
			qcom,non_normal_vterm_hw_inc = <0xa>;
			qcom,non_standard_fastchg_current_ma = <0x200>;
			qcom,non_standard_vfloat_mv = <0xf8c>;
			qcom,non_standard_vfloat_over_sw_limit = <0xfa0>;
			qcom,non_standard_vfloat_sw_limit = <0xf5a>;
			qcom,normal_bat_decidegc = <0xa0>;
			qcom,normal_phase1_bat_decidegc = <0xa0>;
			qcom,normal_phase2_bat_decidegc = <0xdc>;
			qcom,normal_phase3_bat_decidegc = <0x154>;
			qcom,normal_phase4_bat_decidegc = <0x172>;
			qcom,normal_phase5_bat_decidegc = <0x190>;
			qcom,normal_phase6_bat_decidegc = <0x1a4>;
			qcom,normal_vfloat_over_sw_limit = <0x1162>;
			qcom,normal_vfloat_over_sw_limit_2nd = <0x112b>;
			qcom,normal_vfloat_sw_limit = <0x111c>;
			qcom,normal_vterm_hw_inc = <0x96>;
			qcom,pd_input_current_charger_ma = <0x7d0>;
			qcom,pd_temp_normal_fastchg_current_ma = <0xbb8>;
			qcom,qc_input_current_charger_ma = <0x7d0>;
			qcom,qc_temp_cool_fastchg_current_ma_high = <0xabe>;
			qcom,qc_temp_cool_fastchg_current_ma_low = <0xabe>;
			qcom,qc_temp_little_cold_fastchg_current_ma_high = <0xabe>;
			qcom,qc_temp_little_cold_fastchg_current_ma_low = <0x672>;
			qcom,qc_temp_little_cool_fastchg_current_ma = <0xd48>;
			qcom,qc_temp_normal_fastchg_current_ma = <0xbb8>;
			qcom,qc_temp_warm_fastchg_current_ma = <0x672>;
			qcom,recharge-mv = <0x73>;
			qcom,recharge-mv_2nd = <0x79>;
			qcom,removed_bat_decidegc = <0xbe>;
			qcom,short_c_bat_cv_mv = <0x10ea>;
			qcom,short_c_bat_fastchg_current_ma = <0x200>;
			qcom,short_c_bat_vfloat_mv = <0xed8>;
			qcom,short_c_bat_vfloat_sw_limit = <0xea6>;
			qcom,slave_chg_disable_ma = <0x12c>;
			qcom,slave_chg_enable_ma = <0x3e8>;
			qcom,slave_pct = <0x1e>;
			qcom,step1_current_ma = <0x898>;
			qcom,step1_time = <0x258>;
			qcom,step2_current_ma = <0x802>;
			qcom,step2_time = <0x258>;
			qcom,step3_current_ma = <0x672>;
			qcom,sw_vfloat_over_protect_enable;
			qcom,temp_cold_fastchg_current_ma = <0x15e>;
			qcom,temp_cold_vfloat_mv = <0xf8c>;
			qcom,temp_cool_fastchg_current_ma_high = <0x546>;
			qcom,temp_cool_fastchg_current_ma_low = <0x28a>;
			qcom,temp_cool_usbchg_current_ma_high = <0x28a>;
			qcom,temp_cool_usbchg_current_ma_low = <0x226>;
			qcom,temp_cool_vfloat_mv = <0x1153>;
			qcom,temp_cool_vfloat_mv_2nd = <0x1127>;
			qcom,temp_little_cold_fastchg_current_ma = <0x28a>;
			qcom,temp_little_cold_fastchg_current_ma_high = <0x28a>;
			qcom,temp_little_cold_fastchg_current_ma_low = <0x28a>;
			qcom,temp_little_cold_usbchg_current_ma = <0x28a>;
			qcom,temp_little_cold_usbchg_current_ma_high = <0x28a>;
			qcom,temp_little_cold_usbchg_current_ma_low = <0x28a>;
			qcom,temp_little_cold_vfloat_mv = <0x1153>;
			qcom,temp_little_cold_vfloat_mv_2nd = <0x1127>;
			qcom,temp_little_cool_fastchg_current_ma = <0x802>;
			qcom,temp_little_cool_fastchg_current_ma_high = <0x802>;
			qcom,temp_little_cool_fastchg_current_ma_low = <0x802>;
			qcom,temp_little_cool_usbchg_current_ma = <0x226>;
			qcom,temp_little_cool_vfloat_mv = <0x1153>;
			qcom,temp_little_cool_vfloat_mv_2nd = <0x1127>;
			qcom,temp_normal_fastchg_current_ma = <0x7d0>;
			qcom,temp_normal_phase1_fastchg_current_ma = <0x898>;
			qcom,temp_normal_phase1_vfloat_mv = <0x1153>;
			qcom,temp_normal_phase2_fastchg_current_ma_high = <0x898>;
			qcom,temp_normal_phase2_fastchg_current_ma_low = <0x898>;
			qcom,temp_normal_phase2_vfloat_mv = <0x1153>;
			qcom,temp_normal_phase3_fastchg_current_ma_high = <0x7d0>;
			qcom,temp_normal_phase3_fastchg_current_ma_low = <0x7d0>;
			qcom,temp_normal_phase3_vfloat_mv = <0x1153>;
			qcom,temp_normal_phase4_fastchg_current_ma_high = <0x708>;
			qcom,temp_normal_phase4_fastchg_current_ma_low = <0x708>;
			qcom,temp_normal_phase4_vfloat_mv = <0x1153>;
			qcom,temp_normal_phase5_fastchg_current_ma = <0x640>;
			qcom,temp_normal_phase5_vfloat_mv = <0x1153>;
			qcom,temp_normal_phase6_fastchg_current_ma = <0x4b0>;
			qcom,temp_normal_phase6_vfloat_mv = <0x1153>;
			qcom,temp_normal_usbchg_current_ma = <0x226>;
			qcom,temp_normal_vfloat_mv = <0x1153>;
			qcom,temp_normal_vfloat_mv_2nd = <0x1127>;
			qcom,temp_warm_fastchg_current_ma = <0x578>;
			qcom,temp_warm_fastchg_current_ma_led_on = <0x1f4>;
			qcom,temp_warm_usbchg_current_ma = <0x226>;
			qcom,temp_warm_vfloat_mv = <0x1022>;
			qcom,vbatt_full_thr = <0x1130>;
			qcom,vbatt_hv_thr = <0x11c6>;
			qcom,vbatt_num = <0x1>;
			qcom,vbatt_pdqc_to_5v_thr = <0x1144>;
			qcom,vbatt_pdqc_to_9v_thr = <0x1068>;
			qcom,vbatt_power_off = <0xce4>;
			qcom,vbatt_soc_1 = <0xd52>;
			qcom,vfloat_step_mv = <0xa>;
			qcom,vooc_project = <0x0>;
			qcom,warm_bat_decidegc = <0x1b8>;
			qcom,warm_vfloat_over_sw_limit = <0x1036>;
			qcom,warm_vfloat_sw_limit = <0xff0>;
			status = "okay";
		};
	};

	fragment@15 {
		target = <0xffffffff>;

		__overlay__ {

			active@id0 {
				phandle = <0x3>;

				pins_cmd_dat {
					bias-pull-up = <0x0>;
					input-enable;
					pinmux = <0x2b00>;
					slew-rate = <0x0>;
				};
			};

			default@hw_sub_id {
				phandle = <0x1>;
			};

			sleep@id0 {
				phandle = <0x2>;

				pins_cmd_dat {
					bias-pull-down = <0x0>;
					input-enable;
					pinmux = <0x2b00>;
					slew-rate = <0x0>;
				};
			};
		};
	};

	fragment@16 {
		target = <0xffffffff>;

		__overlay__ {
			CAR_TUNE_VALUE_EXT = <0x64>;
			COM_FG_METER_RESISTANCE_EXT = <0x4b>;
			Enable_Battery_Temp_Compensation = <0x0>;
			Enable_Is_Force_Full = <0x1>;
			FG_METER_RESISTANCE_EXT = <0x4b>;
			FUELGAGUE_APPLY = <0x1>;
			R_FG_VALUE_EXT = <0xa>;
			bootmode = <0xffffffff>;
			charger = <0xffffffff>;
			compatible = "mediatek,mt6357-gauge";
			g_FG_PSEUDO100_EXT = <0x62 0x62 0x62 0x62 0x62 0x62 0x62 0x62 0x5e 0x5e 0x5e 0x5e 0x57 0x57 0x57 0x57 0x57 0x57 0x57 0x57 0x64 0x64 0x64 0x64 0x64 0x64 0x64 0x64 0x64 0x64 0x64 0x64 0x64 0x64 0x64 0x64 0x64 0x64 0x64 0x64>;
			g_FG_PSEUDO100_T0_EXT = <0x62>;
			g_FG_PSEUDO100_T1_EXT = <0x62>;
			g_FG_PSEUDO100_T2_EXT = <0x5e>;
			g_FG_PSEUDO100_T3_EXT = <0x57>;
			g_FG_PSEUDO100_T4_EXT = <0x57>;
			g_PMIC_MIN_VOL_EXT = <0x82dc 0x82dc 0x82dc 0x82dc 0x82dc 0x82dc 0x82dc 0x82dc 0x80e8 0x80e8 0x80e8 0x80e8 0x7ef4 0x7ef4 0x7ef4 0x7ef4 0x7b0c 0x7918 0x7918 0x7918 0x7918 0x7918 0x7918 0x7918 0x7918 0x7918 0x7918 0x7918 0x7918 0x7918 0x7918 0x7918 0x7918 0x7918 0x7918 0x7918 0x7918 0x7918 0x7918 0x79e0>;
			g_QMAX_SYS_VOL_EXT = <0x82dc 0x82dc 0x82dc 0x82dc 0x7e2c 0x7e2c 0x7e2c 0x7e2c 0x8020 0x8020 0x8020 0x8020 0x80e8 0x80e8 0x80e8 0x80e8 0x82dc 0x82dc 0x82dc 0x82dc 0x7ef4 0x7ef4 0x7ef4 0x7ef4 0x8020 0x8020 0x8020 0x8020 0x8020 0x8020 0x8020 0x8020 0x8020 0x8020 0x8020 0x8020 0x8020 0x8020 0x8020 0x8020>;
			io-channel-names = "pmic_battery_temp", "pmic_battery_voltage", "pmic_bif_voltage", "pmic_ptim_voltage", "pmic_ptim_r", "auxadc6-batt_id_v";
			io-channels = <0xffffffff 0x3 0xffffffff 0x0 0xffffffff 0xe 0xffffffff 0xf 0xffffffff 0x10 0xffffffff 0x2>;
			nvmem-cell-names = "initialization", "state-of-charge";
			nvmem-cells = <0xffffffff 0xffffffff>;
			status = "okay";
		};
	};

	fragment@17 {
		target = <0xffffffff>;

		__overlay__ {
			compatible = "mediatek,usb_iddig_bi_eint";
			interrupt-parent = <0xffffffff>;
			interrupts = <0x93 0x8 0x93 0x0>;
			pinctrl-0 = <0x12>;
			pinctrl-1 = <0x13>;
			pinctrl-names = "otg_iddg_high", "otg_gpio_low";
		};
	};

	fragment@18 {
		target = <0xffffffff>;

		__overlay__ {

			otg_gpio_low {
				phandle = <0x13>;

				pins_cmd_dat {
					output-low;
					pinmux = <0x2900>;
					slew-rate = <0x1>;
				};
			};

			otg_iddg_high {
				phandle = <0x12>;

				pins_cmd_dat {
					bias-pull-up;
					pinmux = <0x2901>;
					slew-rate = <0x0>;
				};
			};
		};
	};

	fragment@19 {
		target = <0xffffffff>;

		__overlay__ {
			pinctrl-0 = <0x14>;
			pinctrl-1 = <0x15>;
			pinctrl-names = "uart0_rx_gpio", "uart0_tx_gpio";
			status = "okay";
		};
	};

	fragment@2 {
		target = <0xffffffff>;

		__overlay__ {
			status = "okay";

			lcm_bias@3e {
				compatible = "LCD_BIAS_NT5038";
				reg = <0x3e>;
				status = "okay";
			};

			nfc_nxp@28 {
				compatible = "nxp,pn544";
				interrupt-parent = <0xffffffff>;
				nxp,pn544-fw-dwnld = <0xffffffff 0x8 0x0>;
				nxp,pn544-irq = <0xffffffff 0x4 0x0>;
				nxp,pn544-ven = <0xffffffff 0x9f 0x0>;
				reg = <0x28>;
			};
		};
	};

	fragment@20 {
		target = <0xffffffff>;

		__overlay__ {

			uart0_rx_gpio@gpio95 {
				phandle = <0x14>;

				pins_cmd_dat {
					bias-pull-down;
					input-enable;
					pinmux = <0x5f00>;
					slew-rate = <0x0>;
				};
			};

			uart0_tx_gpio@gpio96 {
				phandle = <0x15>;

				pins_cmd_dat {
					bias-pull-down;
					input-enable;
					pinmux = <0x6000>;
					slew-rate = <0x0>;
				};
			};
		};
	};

	fragment@21 {
		target = <0xffffffff>;

		__overlay__ {

			pmic_accdet {
				headset-three-key-threshold = <0x0 0x50 0xdc 0x190>;
				phandle = <0x6a>;
			};
		};
	};

	fragment@22 {
		target = <0xffffffff>;

		__overlay__ {
			accdet-mic-mode = <0x1>;
			accdet-mic-vol = <0x7>;
			accdet-plugout-debounce = <0x1>;
			headset-eint-level-pol = <0x8>;
			headset-four-key-threshold = <0x0 0x3a 0x79 0xc0 0x190>;
			headset-mode-setting = <0x500 0x500 0x1 0x1f0 0x800 0x800 0x20 0x44>;
			headset-three-key-threshold = <0x0 0x50 0xdc 0x190>;
			headset-three-key-threshold-CDD = <0x0 0x79 0xc0 0x258>;
			pinctrl-0 = <0x16>;
			pinctrl-1 = <0x17>;
			pinctrl-names = "default", "state_eint_as_int";
			status = "okay";
		};
	};

	fragment@23 {
		target = <0xffffffff>;

		__overlay__ {

			accdetdefault {
				phandle = <0x16>;
			};

			accdeteint@0 {
				phandle = <0x17>;

				pins_cmd_dat {
					bias-disable;
					pinmux = <0x900>;
					slew-rate = <0x0>;
				};
			};
		};
	};

	fragment@24 {
		target = <0xffffffff>;

		__overlay__ {
			#address-cells = <0x1>;
			#size-cells = <0x0>;
			status = "okay";

			finger_spi@0 {
				compatible = "oppo,oppo_fp";
				goodix,pw_en = <0xffffffff 0x9e 0x0>;
				netlink-event = <0x1e>;
				reg = <0x0>;
				spi-id = <0x1>;
				spi-irq = <0x7a>;
				spi-max-frequency = <0x7a1200>;
				spi-reg = <0x11010000>;
				status = "okay";

				power_source_1 {
					delay-time = <0x0>;
					power-mode = <0x2>;
					power-name = "goodix,pw_en";
				};
			};
		};
	};

	fragment@25 {
		target = <0xffffffff>;

		__overlay__ {

			goodix_irq_no_pull {
				phandle = <0x1a>;

				pins_cmd_dat {
					bias-disable;
					pinmux = <0x300>;
					slew-rate = <0x0>;
				};
			};

			goodix_irq_out_low {
				phandle = <0x19>;

				pins_cmd_dat {
					output-low;
					pinmux = <0x300>;
					slew-rate = <0x1>;
				};
			};

			goodix_power_cs {
				phandle = <0x1b>;

				pins_cmd_dat {
					bias-disable;
					output-high;
					pinmux = <0x9e00>;
					slew-rate = <0x1>;
				};
			};

			goodix_reset_default {
				phandle = <0x18>;

				pins_cmd_dat {
					output-low;
					pinmux = <0xab00>;
					slew-rate = <0x1>;
				};
			};
		};
	};

	fragment@26 {
		target = <0xffffffff>;

		__overlay__ {
			gf,cs_gpio_disable = <0x1>;
			goodix,gpio_cs = <0xffffffff 0x9e 0x0>;
			goodix,gpio_irq = <0xffffffff 0x3 0x0>;
			goodix,gpio_reset = <0xffffffff 0xab 0x0>;
			interrupt-parent = <0xffffffff>;
			interrupts = <0x3 0x0>;
			pinctrl-0 = <0x18>;
			pinctrl-1 = <0x19>;
			pinctrl-2 = <0x1a>;
			pinctrl-3 = <0x1b>;
			pinctrl-names = "goodix_reset_default", "goodix_irq_out_low", "goodix_irq_no_pull", "goodix_power_cs";
			spi-max-frequency = <0x7a1200>;
			status = "okay";
		};
	};

	fragment@27 {
		target = <0xffffffff>;

		__overlay__ {

			fp_eint@8 {
				phandle = <0x1f>;

				pins_cmd_dat {
					bias-disable;
					pinmux = <0x300>;
					slew-rate = <0x0>;
				};
			};

			silfpdefault {
				phandle = <0x1c>;
			};

			state_power18_high {
				phandle = <0x22>;

				pins_cmd_dat {
					output-high;
					pinmux = <0x9e00>;
					slew-rate = <0x1>;
				};
			};

			state_power18_low {
				phandle = <0x23>;

				pins_cmd_dat {
					output-low;
					pinmux = <0x4f00>;
					slew-rate = <0x1>;
				};
			};

			state_power_high {
				phandle = <0x20>;

				pins_cmd_dat {
					output-high;
					pinmux = <0x9e00>;
					slew-rate = <0x1>;
				};
			};

			state_power_low {
				phandle = <0x21>;

				pins_cmd_dat {
					output-low;
					pinmux = <0x9e00>;
					slew-rate = <0x1>;
				};
			};

			state_reset_high {
				phandle = <0x1e>;

				pins_cmd_dat {
					output-high;
					pinmux = <0xab00>;
					slew-rate = <0x1>;
				};
			};

			state_reset_low {
				phandle = <0x1d>;

				pins_cmd_dat {
					output-low;
					pinmux = <0xab00>;
					slew-rate = <0x1>;
				};
			};
		};
	};

	fragment@28 {
		target = <0xffffffff>;

		__overlay__ {
			pinctrl-0 = <0x1c>;
			pinctrl-1 = <0x1d>;
			pinctrl-2 = <0x1e>;
			pinctrl-3 = <0x1f>;
			pinctrl-4 = <0x20>;
			pinctrl-5 = <0x21>;
			pinctrl-6 = <0x22>;
			pinctrl-7 = <0x23>;
			pinctrl-names = "default", "rst-low", "rst-high", "irq-init", "power_high", "power_low", "power18_high", "power18_low";
			sil,ldo_disable = <0x1>;
			sil,silead_irq = <0xffffffff 0x3 0x0>;
			status = "okay";
		};
	};

	fragment@29 {
		target = <0xffffffff>;

		__overlay__ {

			gpio_id0_default {
				phandle = <0x24>;

				pins_cmd_dat {
					bias-pull-up = <0x0>;
					pinmux = <0xaa00>;
					slew-rate = <0x0>;
				};
			};

			gpio_id0_pull_down {
				phandle = <0x26>;

				pins_cmd_dat {
					bias-pull-down = <0x0>;
					pinmux = <0xaa00>;
					slew-rate = <0x0>;
				};
			};

			gpio_id0_pull_up {
				phandle = <0x25>;

				pins_cmd_dat {
					bias-pull-up = <0x0>;
					pinmux = <0xaa00>;
					slew-rate = <0x0>;
				};
			};
		};
	};

	fragment@3 {
		target = <0xffffffff>;

		__overlay__ {
			compatible = "mediatek, swtp-eint";
		};
	};

	fragment@30 {
		target = <0xffffffff>;

		__overlay__ {

			gpio_id1_default {
				phandle = <0x27>;

				pins_cmd_dat {
					bias-pull-up = <0x0>;
					pinmux = <0xad00>;
					slew-rate = <0x0>;
				};
			};

			gpio_id1_pull_down {
				phandle = <0x29>;

				pins_cmd_dat {
					bias-pull-down = <0x0>;
					pinmux = <0xad00>;
					slew-rate = <0x0>;
				};
			};

			gpio_id1_pull_up {
				phandle = <0x28>;

				pins_cmd_dat {
					bias-pull-up = <0x0>;
					pinmux = <0xad00>;
					slew-rate = <0x0>;
				};
			};
		};
	};

	fragment@31 {
		target = <0xffffffff>;

		__overlay__ {
			compatible = "oplus,fp_common";
			oplus,fp_gpio_0 = <0xffffffff 0xaa 0x0>;
			oplus,fp_gpio_1 = <0xffffffff 0xad 0x0>;
			oplus,fp_gpio_num = <0x2>;
			pinctrl-0 = <0x24>;
			pinctrl-1 = <0x25>;
			pinctrl-2 = <0x26>;
			pinctrl-3 = <0x27>;
			pinctrl-4 = <0x28>;
			pinctrl-5 = <0x29>;
			pinctrl-names = "gpio_id0_default", "gpio_id0_pull_up", "gpio_id0_pull_down", "gpio_id1_default", "gpio_id1_pull_up", "gpio_id1_pull_down";

			gf_3688 {
				chip-name = "G_3688";
				eng-menu = "-1,-1";
				oplus,fp-id = <0x1 0x0>;
				vendor-chip = <0x10>;
			};

			silead_6135 {
				chip-name = "G_6135";
				eng-menu = "-1,-1";
				oplus,fp-id = <0x0 0x1>;
				vendor-chip = <0x15>;
			};

			silead_6150 {
				chip-name = "S_gsl6150";
				eng-menu = "-1,-1";
				oplus,fp-id = <0x0 0x0>;
				vendor-chip = <0x15>;
			};
		};
	};

	fragment@32 {
		target = <0xffffffff>;

		__overlay__ {
			pinctrl-0 = <0x2a>;
			pinctrl-1 = <0x2b>;
			pinctrl-names = "irtx_gpio_led_default", "irtx_gpio_led_set";
			status = "okay";
		};
	};

	fragment@33 {
		target = <0xffffffff>;

		__overlay__ {

			irtx_gpio_led_def@gpio90 {
				phandle = <0x2a>;

				pins_cmd_dat {
					bias-disable;
					input-schmitt-enable = <0x0>;
					output-low;
					pinmux = <0x5a00>;
					slew-rate = <0x1>;
				};
			};

			irtx_gpio_led_set@gpio90 {
				phandle = <0x2b>;

				pins_cmd_dat {
					output-high;
					pinmux = <0x5a02>;
					slew-rate = <0x1>;
				};
			};
		};
	};

	fragment@34 {
		target = <0xffffffff>;

		__overlay__ {
			pinctrl-0 = <0x2c>;
			pinctrl-1 = <0x2d>;
			pinctrl-2 = <0x2e>;
			pinctrl-3 = <0x2f>;
			pinctrl-4 = <0x30>;
			pinctrl-5 = <0x31>;
			pinctrl-6 = <0x32>;
			pinctrl-7 = <0x33>;
			pinctrl-8 = <0x34>;
			pinctrl-9 = <0x35>;
			pinctrl-names = "aud_clk_mosi_off", "aud_clk_mosi_on", "aud_clk_miso_off", "aud_clk_miso_on", "aud_dat_mosi_off", "aud_dat_mosi_on", "aud_dat_miso_off", "aud_dat_miso_on", "extamp-pulllow", "extamp-pullhigh";
			status = "okay";
		};
	};

	fragment@35 {
		target = <0xffffffff>;

		__overlay__ {

			aud_clk_miso_off {
				phandle = <0x2e>;

				pins_cmd0_dat {
					pinmux = <0x8c00>;
				};
			};

			aud_clk_miso_on {
				phandle = <0x2f>;

				pins_cmd0_dat {
					pinmux = <0x8c01>;
				};
			};

			aud_clk_mosi_off {
				phandle = <0x2c>;

				pins_cmd0_dat {
					pinmux = <0x8800>;
				};
			};

			aud_clk_mosi_on {
				phandle = <0x2d>;

				pins_cmd0_dat {
					pinmux = <0x8801>;
				};
			};

			aud_dat_miso_off {
				phandle = <0x32>;

				pins_cmd1_dat {
					bias-disable;
					input-enable;
					pinmux = <0x8e00>;
					slew-rate = <0x0>;
				};

				pins_cmd2_dat {
					bias-disable;
					input-enable;
					pinmux = <0x8f00>;
					slew-rate = <0x0>;
				};
			};

			aud_dat_miso_on {
				phandle = <0x33>;

				pins_cmd1_dat {
					pinmux = <0x8e01>;
				};

				pins_cmd2_dat {
					pinmux = <0x8f01>;
				};
			};

			aud_dat_mosi_off {
				phandle = <0x30>;

				pins_cmd1_dat {
					bias-disable;
					input-enable;
					pinmux = <0x8a00>;
					slew-rate = <0x0>;
				};

				pins_cmd2_dat {
					bias-disable;
					input-enable;
					pinmux = <0x8b00>;
					slew-rate = <0x0>;
				};
			};

			aud_dat_mosi_on {
				phandle = <0x31>;

				pins_cmd1_dat {
					pinmux = <0x8a01>;
				};

				pins_cmd2_dat {
					pinmux = <0x8b01>;
				};
			};

			aud_pins_extamp_pullhigh {
				phandle = <0x35>;

				pins_cmd_dat {
					output-high;
					pinmux = <0x9600>;
					slew-rate = <0x1>;
				};
			};

			aud_pins_extamp_pulllow {
				phandle = <0x34>;

				pins_cmd_dat {
					output-low;
					pinmux = <0x9600>;
					slew-rate = <0x1>;
				};
			};
		};
	};

	fragment@36 {
		target = <0xffffffff>;

		__overlay__ {
			mt6370,intr_gpio = <0xffffffff 0xb 0x0>;
			mt6370,intr_gpio_num = <0xb>;
		};
	};

	fragment@37 {
		target = <0xffffffff>;

		__overlay__ {
			mt6370pd,intr_gpio = <0xffffffff 0x29 0x0>;
			mt6370pd,intr_gpio_num = <0x29>;
		};
	};

	fragment@38 {
		target = <0xffffffff>;

		__overlay__ {
			bc12_sel = <0x1>;
		};
	};

	fragment@39 {
		target = <0xffffffff>;

		__overlay__ {

			touchscreen@0 {
				black_gesture_support;
				black_gesture_test_support;
				charger_pump_support;
				chip-name = "OPPO_TP_NOFLASH";
				compatible = "oppo,tp_noflash";
				drlimit_remove_support;
				esd_handle_support;
				fw_edge_limit_support;
				fw_update_app_support;
				fw_update_in_probe_with_headfile;
				game_switch_support;
				headset_pump_support;
				incell_screen;
				interrupt-parent = <0xffffffff>;
				interrupts = <0x0 0x2 0x0 0x0>;
				irq-gpio = <0xffffffff 0x0 0x2002>;
				irq_need_dev_resume_ok;
				lcd_trigger_load_tp_fw_support;
				noflash_support;
				pinctrl-0 = <0x36>;
				pinctrl-names = "default";
				platform_support_project = <0x50dd>;
				platform_support_project_commandline = "default_commandline";
				platform_support_project_dir = <0x50dd>;
				pressure_report_support;
				reg = <0x0>;
				reset-gpio = <0xffffffff 0xb2 0x0>;
				smart_gesture_support;
				spi-max-frequency = <0xe4e1c0>;
				status = "ok";
				suspend_gesture_cfg;
				touchpanel,button-type = <0x4>;
				touchpanel,display-coords = <0x2d0 0x640>;
				touchpanel,max-num-support = <0xa>;
				touchpanel,panel-coords = <0x2d0 0x640>;
				touchpanel,touchmajor-limit = <0x0 0x36>;
				touchpanel,tx-rx-num = <0x12 0x20>;
			};
		};
	};

	fragment@4 {
		target = <0xffffffff>;

		__overlay__ {

			lcd_bias_enn0_gpio {
				phandle = <0x8>;

				pins_cmd_dat {
					output-low;
					pinmux = <0xa500>;
					slew-rate = <0x1>;
				};
			};

			lcd_bias_enn1_gpio {
				phandle = <0x9>;

				pins_cmd_dat {
					output-high;
					pinmux = <0xa500>;
					slew-rate = <0x1>;
				};
			};

			lcd_bias_enp0_gpio {
				phandle = <0x6>;

				pins_cmd_dat {
					output-low;
					pinmux = <0xa600>;
					slew-rate = <0x1>;
				};
			};

			lcd_bias_enp1_gpio {
				phandle = <0x7>;

				pins_cmd_dat {
					output-high;
					pinmux = <0xa600>;
					slew-rate = <0x1>;
				};
			};

			lcm_rst_out0_gpio {
				phandle = <0x4>;

				pins_cmd_dat {
					output-low;
					pinmux = <0x2d00>;
					slew-rate = <0x1>;
				};
			};

			lcm_rst_out1_gpio {
				phandle = <0x5>;

				pins_cmd_dat {
					output-high;
					pinmux = <0x2d00>;
					slew-rate = <0x1>;
				};
			};
		};
	};

	fragment@40 {
		target = <0xffffffff>;

		__overlay__ {

			ctp_ts_spi_mode {
				phandle = <0x36>;

				pins_cmd_dat {
					drive-strength = <0x4>;
					pinmux = <0x1102 0x1202 0x1302 0x1402>;
				};
			};
		};
	};

	fragment@41 {
		target = <0xffffffff>;

		__overlay__ {

			adc_channel@ {
				compatible = "mediatek,adc_channel";
				mediatek,adc_fdd_rf_params_dynamic_custom_ch = <0x4>;
				mediatek,temperature0 = <0x0>;
				mediatek,temperature1 = <0x1>;
				status = "okay";
			};
		};
	};

	fragment@42 {
		target = <0xffffffff>;

		__overlay__ {
			io-channels = <0xffffffff 0x4>;
		};
	};

	fragment@43 {
		target = <0xffffffff>;

		__overlay__ {
			mediatek,clkbuf-config = <0x2 0x1 0x1 0x2 0x0 0x0 0x0>;
			mediatek,clkbuf-driving-current = <0x1 0x1 0x1 0x1 0x1 0x1 0x1>;
			mediatek,clkbuf-quantity = <0x7>;
			status = "okay";
		};
	};

	fragment@44 {
		target = <0xffffffff>;

		__overlay__ {
			#address-cells = <0x1>;
			#size-cells = <0x0>;
			clock-frequency = <0x61a80>;
			mediatek,use-open-drain;
		};
	};

	fragment@45 {
		target = <0xffffffff>;

		__overlay__ {
			#address-cells = <0x1>;
			#size-cells = <0x0>;
			clock-frequency = <0x61a80>;
			mediatek,use-open-drain;
		};
	};

	fragment@46 {
		target = <0xffffffff>;

		__overlay__ {
			#address-cells = <0x1>;
			#size-cells = <0x0>;
			clock-frequency = <0x61a80>;
			mediatek,use-open-drain;

			camera_main@1a {
				compatible = "mediatek,camera_main";
				phandle = <0x6b>;
				reg = <0x1a>;
				status = "okay";
			};

			camera_main_af@0c {
				compatible = "mediatek,camera_main_af";
				phandle = <0x6d>;
				reg = <0xc>;
				status = "okay";
			};

			camera_main_eeprom@50 {
				compatible = "mediatek,camera_main_eeprom";
				phandle = <0x6c>;
				reg = <0x50>;
				status = "okay";
			};
		};
	};

	fragment@47 {
		target = <0xffffffff>;

		__overlay__ {
			#address-cells = <0x1>;
			#size-cells = <0x0>;
			clock-frequency = <0x61a80>;
			mediatek,use-open-drain;

			slave_charger@4b {
				compatible = "mediatek,slave_charger";
				phandle = <0x6f>;
				reg = <0x4b>;
				status = "okay";
			};

			speaker_amp@34 {
				compatible = "mediatek,speaker_amp";
				phandle = <0x6e>;
				reg = <0x34>;
				status = "okay";
			};
		};
	};

	fragment@48 {
		target = <0xffffffff>;

		__overlay__ {
			#address-cells = <0x1>;
			#size-cells = <0x0>;
			clock-frequency = <0x61a80>;
			mediatek,use-open-drain;

			camera_sub@2d {
				compatible = "mediatek,camera_sub";
				phandle = <0x70>;
				reg = <0x2d>;
				status = "okay";
			};

			camera_sub_eeprom@52 {
				compatible = "mediatek,camera_sub_eeprom";
				phandle = <0x71>;
				reg = <0x52>;
				status = "okay";
			};
		};
	};

	fragment@49 {
		target = <0xffffffff>;

		__overlay__ {
			#address-cells = <0x1>;
			#size-cells = <0x0>;
			clock-frequency = <0x61a80>;
			mediatek,use-push-pull;

			subpmic_pmu@34 {
				compatible = "mediatek,subpmic_pmu";
				phandle = <0x72>;
				reg = <0x34>;
				status = "okay";
			};

			usb_type_c@4e {
				compatible = "mediatek,usb_type_c";
				phandle = <0x73>;
				reg = <0x4e>;
				status = "okay";
			};
		};
	};

	fragment@5 {
		target = <0xffffffff>;

		__overlay__ {
			pinctrl-0 = <0x4>;
			pinctrl-1 = <0x5>;
			pinctrl-2 = <0x6>;
			pinctrl-3 = <0x7>;
			pinctrl-4 = <0x8>;
			pinctrl-5 = <0x9>;
			pinctrl-names = "lcm_rst_out0_gpio", "lcm_rst_out1_gpio", "lcd_bias_enp0_gpio", "lcd_bias_enp1_gpio", "lcd_bias_enn0_gpio", "lcd_bias_enn1_gpio";
			status = "okay";
		};
	};

	fragment@50 {
		target = <0xffffffff>;

		__overlay__ {
			#address-cells = <0x1>;
			#size-cells = <0x0>;
			clock-frequency = <0x61a80>;
			mediatek,use-open-drain;

			ext_buck_lp4@57 {
				compatible = "mediatek,ext_buck_lp4";
				phandle = <0x75>;
				reg = <0x57>;
				status = "okay";
			};

			ext_buck_lp4x@50 {
				compatible = "mediatek,ext_buck_lp4x";
				phandle = <0x76>;
				reg = <0x50>;
				status = "okay";
			};

			ext_buck_vgpu@55 {
				compatible = "mediatek,ext_buck_vgpu";
				phandle = <0x74>;
				reg = <0x55>;
				status = "okay";
			};
		};
	};

	fragment@51 {
		target = <0xffffffff>;

		__overlay__ {
			#address-cells = <0x1>;
			#size-cells = <0x0>;
			clock-frequency = <0x61a80>;
			mediatek,use-open-drain;
		};
	};

	fragment@52 {
		target = <0xffffffff>;

		__overlay__ {
			#address-cells = <0x1>;
			#size-cells = <0x0>;
			clock-frequency = <0x61a80>;
			mediatek,use-open-drain;
		};
	};

	fragment@53 {
		target = <0xffffffff>;

		__overlay__ {
			#address-cells = <0x1>;
			#size-cells = <0x0>;
			clock-frequency = <0x61a80>;
			mediatek,use-open-drain;
		};
	};

	fragment@54 {
		target = <0xffffffff>;

		__overlay__ {
			GPIO_FDD_BAND_SUPPORT_DETECT_1ST_PIN = <0xffffffff 0x4f 0x0>;
			GPIO_FDD_BAND_SUPPORT_DETECT_2ND_PIN = <0xffffffff 0x50 0x0>;
			GPIO_FDD_BAND_SUPPORT_DETECT_3RD_PIN = <0xffffffff 0x34 0x0>;
			GPIO_FDD_BAND_SUPPORT_DETECT_4TH_PIN = <0xffffffff 0x4d 0x0>;
			GPIO_SIM1_HOT_PLUG = <0xffffffff 0x2f 0x0>;
			GPIO_SIM1_SCLK = <0xffffffff 0x26 0x0>;
			GPIO_SIM1_SIO = <0xffffffff 0x28 0x0>;
			GPIO_SIM1_SRST = <0xffffffff 0x27 0x0>;
			GPIO_SIM2_HOT_PLUG = <0xffffffff 0x2e 0x0>;
			GPIO_SIM2_SCLK = <0xffffffff 0x25 0x0>;
			GPIO_SIM2_SIO = <0xffffffff 0x23 0x0>;
			GPIO_SIM2_SRST = <0xffffffff 0x24 0x0>;
		};
	};

	fragment@55 {
		target = <0xffffffff>;

		__overlay__ {
			gpio_init_default = <0x0 0x0 0x0 0x0 0x1 0x1 0x1 0x1 0x0 0x0 0x0 0x1 0x1 0x1 0x2 0x0 0x0 0x0 0x1 0x1 0x1 0x3 0x0 0x0 0x0 0x0 0x0 0x1 0x4 0x0 0x0 0x0 0x0 0x0 0x0 0x5 0x0 0x0 0x0 0x1 0x1 0x0 0x6 0x0 0x1 0x0 0x0 0x0 0x0 0x7 0x0 0x1 0x0 0x1 0x0 0x0 0x8 0x0 0x1 0x0 0x0 0x0 0x0 0x9 0x0 0x0 0x0 0x1 0x1 0x0 0xa 0x0 0x0 0x0 0x1 0x1 0x0 0xb 0x0 0x0 0x0 0x1 0x1 0x0 0xc 0x0 0x0 0x0 0x1 0x1 0x0 0xd 0x3 0x0 0x0 0x1 0x0 0x0 0xe 0x3 0x1 0x0 0x0 0x0 0x0 0xf 0x3 0x1 0x0 0x0 0x0 0x0 0x10 0x3 0x1 0x0 0x0 0x0 0x0 0x11 0x2 0x0 0x0 0x1 0x0 0x0 0x12 0x2 0x1 0x0 0x0 0x0 0x0 0x13 0x2 0x1 0x0 0x0 0x0 0x0 0x14 0x2 0x1 0x0 0x0 0x0 0x0 0x15 0x1 0x0 0x0 0x1 0x0 0x0 0x16 0x1 0x1 0x0 0x0 0x0 0x0 0x17 0x1 0x1 0x0 0x0 0x0 0x0 0x18 0x1 0x1 0x0 0x0 0x0 0x0 0x19 0x1 0x0 0x0 0x1 0x0 0x0 0x1a 0x1 0x1 0x0 0x0 0x0 0x0 0x1b 0x1 0x1 0x0 0x0 0x0 0x0 0x1c 0x1 0x1 0x0 0x0 0x0 0x0 0x1d 0x1 0x1 0x0 0x0 0x0 0x1 0x1e 0x1 0x0 0x0 0x1 0x1 0x1 0x1f 0x1 0x0 0x0 0x1 0x1 0x1 0x20 0x1 0x0 0x0 0x1 0x1 0x1 0x21 0x1 0x0 0x0 0x1 0x1 0x1 0x22 0x1 0x0 0x0 0x1 0x1 0x1 0x23 0x1 0x0 0x0 0x1 0x1 0x0 0x24 0x1 0x1 0x0 0x0 0x0 0x0 0x25 0x1 0x1 0x0 0x0 0x0 0x0 0x26 0x1 0x1 0x0 0x0 0x0 0x0 0x27 0x1 0x1 0x0 0x0 0x0 0x0 0x28 0x1 0x0 0x0 0x1 0x1 0x0 0x29 0x0 0x0 0x0 0x1 0x1 0x0 0x2a 0x0 0x0 0x0 0x1 0x0 0x0 0x2b 0x1 0x1 0x0 0x0 0x0 0x0 0x2c 0x1 0x0 0x0 0x1 0x0 0x0 0x2d 0x0 0x1 0x0 0x0 0x0 0x0 0x2e 0x1 0x0 0x0 0x1 0x1 0x0 0x2f 0x1 0x0 0x0 0x1 0x1 0x0 0x30 0x1 0x0 0x0 0x1 0x1 0x1 0x31 0x1 0x0 0x0 0x1 0x1 0x1 0x32 0x1 0x0 0x0 0x1 0x1 0x1 0x33 0x1 0x0 0x0 0x1 0x1 0x1 0x34 0x0 0x0 0x0 0x1 0x0 0x0 0x35 0x1 0x1 0x0 0x1 0x0 0x0 0x36 0x1 0x1 0x0 0x1 0x0 0x0 0x37 0x0 0x0 0x0 0x0 0x0 0x0 0x38 0x1 0x1 0x0 0x1 0x0 0x0 0x39 0x1 0x1 0x0 0x1 0x0 0x0 0x3a 0x0 0x0 0x0 0x1 0x0 0x0 0x3b 0x1 0x0 0x0 0x1 0x0 0x0 0x3c 0x1 0x0 0x0 0x1 0x0 0x0 0x3d 0x1 0x0 0x0 0x1 0x0 0x0 0x3e 0x1 0x0 0x0 0x1 0x0 0x0 0x3f 0x1 0x0 0x0 0x1 0x0 0x0 0x40 0x1 0x0 0x0 0x1 0x0 0x0 0x41 0x1 0x0 0x0 0x1 0x0 0x0 0x42 0x1 0x0 0x0 0x1 0x0 0x0 0x43 0x1 0x0 0x0 0x1 0x0 0x0 0x44 0x1 0x0 0x0 0x1 0x0 0x0 0x45 0x1 0x1 0x0 0x1 0x0 0x0 0x46 0x1 0x1 0x0 0x1 0x0 0x0 0x47 0x1 0x1 0x0 0x1 0x0 0x0 0x48 0x1 0x1 0x0 0x1 0x0 0x0 0x49 0x1 0x1 0x0 0x1 0x0 0x0 0x4a 0x1 0x1 0x0 0x1 0x0 0x0 0x4b 0x1 0x1 0x0 0x1 0x0 0x0 0x4c 0x0 0x0 0x0 0x0 0x0 0x0 0x4d 0x0 0x0 0x0 0x1 0x0 0x0 0x4e 0x1 0x1 0x0 0x1 0x0 0x0 0x4f 0x0 0x0 0x0 0x1 0x0 0x0 0x50 0x0 0x0 0x0 0x1 0x0 0x0 0x51 0x1 0x0 0x0 0x1 0x1 0x1 0x52 0x1 0x0 0x0 0x1 0x1 0x1 0x53 0x1 0x0 0x0 0x1 0x1 0x1 0x54 0x1 0x0 0x0 0x1 0x1 0x1 0x55 0x1 0x1 0x0 0x1 0x0 0x0 0x56 0x1 0x1 0x0 0x1 0x0 0x0 0x57 0x0 0x1 0x0 0x1 0x0 0x0 0x58 0x0 0x1 0x0 0x1 0x0 0x0 0x59 0x1 0x0 0x0 0x1 0x0 0x0 0x5a 0x0 0x0 0x0 0x0 0x0 0x0 0x5b 0x0 0x1 0x0 0x1 0x0 0x0 0x5c 0x1 0x1 0x0 0x0 0x0 0x0 0x5d 0x1 0x0 0x0 0x1 0x1 0x0 0x5e 0x1 0x0 0x0 0x1 0x1 0x0 0x5f 0x1 0x0 0x0 0x1 0x1 0x0 0x60 0x1 0x1 0x0 0x0 0x0 0x0 0x61 0x0 0x0 0x0 0x1 0x0 0x0 0x62 0x0 0x0 0x0 0x1 0x0 0x0 0x63 0x1 0x1 0x0 0x0 0x0 0x0 0x64 0x1 0x1 0x0 0x0 0x0 0x0 0x65 0x0 0x1 0x0 0x0 0x0 0x0 0x66 0x0 0x1 0x0 0x0 0x0 0x0 0x67 0x1 0x0 0x0 0x1 0x1 0x1 0x68 0x1 0x0 0x0 0x1 0x1 0x1 0x69 0x1 0x0 0x0 0x1 0x1 0x1 0x6a 0x1 0x0 0x0 0x1 0x1 0x1 0x6b 0x0 0x1 0x0 0x0 0x0 0x0 0x6c 0x1 0x1 0x0 0x0 0x0 0x0 0x6d 0x0 0x1 0x0 0x0 0x0 0x0 0x6e 0x0 0x0 0x0 0x1 0x0 0x0 0x6f 0x0 0x0 0x0 0x1 0x0 0x0 0x70 0x0 0x0 0x0 0x1 0x0 0x0 0x71 0x0 0x0 0x0 0x1 0x0 0x0 0x72 0x0 0x0 0x0 0x1 0x0 0x0 0x73 0x0 0x0 0x0 0x1 0x0 0x0 0x74 0x0 0x0 0x0 0x1 0x0 0x0 0x75 0x0 0x0 0x0 0x1 0x0 0x0 0x76 0x0 0x0 0x0 0x1 0x0 0x0 0x77 0x0 0x0 0x0 0x1 0x0 0x0 0x78 0x0 0x0 0x0 0x1 0x0 0x0 0x79 0x0 0x0 0x0 0x1 0x0 0x0 0x7a 0x1 0x0 0x0 0x1 0x1 0x1 0x7b 0x1 0x0 0x0 0x1 0x1 0x1 0x7c 0x1 0x1 0x0 0x0 0x0 0x1 0x7d 0x1 0x0 0x0 0x1 0x1 0x1 0x7e 0x1 0x0 0x0 0x1 0x1 0x1 0x7f 0x1 0x0 0x0 0x1 0x1 0x1 0x80 0x1 0x0 0x0 0x1 0x1 0x1 0x81 0x1 0x0 0x0 0x1 0x1 0x1 0x82 0x1 0x0 0x0 0x1 0x1 0x1 0x83 0x1 0x0 0x0 0x1 0x0 0x1 0x84 0x1 0x0 0x0 0x1 0x1 0x1 0x85 0x1 0x1 0x1 0x0 0x0 0x1 0x86 0x1 0x0 0x0 0x1 0x0 0x1 0x87 0x1 0x1 0x0 0x0 0x0 0x0 0x88 0x1 0x1 0x0 0x0 0x0 0x0 0x89 0x1 0x1 0x0 0x0 0x0 0x0 0x8a 0x1 0x1 0x0 0x0 0x0 0x0 0x8b 0x1 0x1 0x0 0x0 0x0 0x0 0x8c 0x1 0x0 0x0 0x1 0x0 0x0 0x8d 0x1 0x0 0x0 0x1 0x0 0x0 0x8e 0x1 0x0 0x0 0x1 0x0 0x0 0x8f 0x1 0x0 0x0 0x1 0x0 0x0 0x90 0x1 0x0 0x0 0x1 0x0 0x0 0x91 0x1 0x1 0x1 0x0 0x0 0x0 0x92 0x1 0x0 0x0 0x1 0x0 0x0 0x93 0x1 0x1 0x0 0x0 0x0 0x0 0x94 0x1 0x1 0x0 0x0 0x0 0x0 0x95 0x1 0x1 0x0 0x0 0x0 0x0 0x96 0x0 0x1 0x0 0x0 0x0 0x0 0x97 0x0 0x1 0x0 0x0 0x0 0x0 0x98 0x0 0x1 0x0 0x1 0x1 0x0 0x99 0x0 0x1 0x0 0x1 0x1 0x0 0x9a 0x0 0x1 0x0 0x0 0x0 0x0 0x9b 0x0 0x1 0x0 0x0 0x0 0x0 0x9c 0x0 0x1 0x0 0x0 0x0 0x0 0x9d 0x1 0x0 0x0 0x1 0x0 0x0 0x9e 0x0 0x1 0x1 0x0 0x0 0x0 0x9f 0x0 0x1 0x0 0x0 0x0 0x0 0xa0 0x0 0x1 0x0 0x0 0x0 0x0 0xa1 0x1 0x0 0x0 0x1 0x1 0x1 0xa2 0x1 0x0 0x0 0x1 0x1 0x1 0xa3 0x0 0x0 0x0 0x1 0x0 0x0 0xa4 0x0 0x0 0x0 0x1 0x0 0x0 0xa5 0x0 0x1 0x0 0x1 0x0 0x0 0xa6 0x0 0x0 0x0 0x1 0x0 0x0 0xa7 0x0 0x0 0x1 0x1 0x1 0x0 0xa8 0x0 0x0 0x0 0x1 0x0 0x0 0xa9 0x0 0x1 0x0 0x0 0x0 0x0 0xaa 0x0 0x0 0x0 0x0 0x0 0x0 0xab 0x0 0x1 0x0 0x0 0x0 0x0 0xac 0x0 0x1 0x1 0x0 0x0 0x0 0xad 0x0 0x1 0x0 0x0 0x0 0x0 0xae 0x0 0x1 0x0 0x0 0x0 0x0 0xaf 0x0 0x1 0x0 0x0 0x0 0x0 0xb0 0x0 0x1 0x0 0x0 0x0 0x0 0xb1 0x0 0x1 0x0 0x0 0x0 0x0 0xb2 0x0 0x1 0x0 0x0 0x0 0x0 0xb3 0x0 0x0 0x0 0x1 0x0 0x0>;
		};
	};

	fragment@56 {
		target = <0xffffffff>;

		__overlay__ {
			interrupt-parent = <0xffffffff>;
			interrupts = <0x0 0x2 0x0 0x0>;
			status = "okay";
		};
	};

	fragment@57 {
		target = <0xffffffff>;

		__overlay__ {
			interrupt-parent = <0xffffffff>;
			interrupts = <0x1 0x1 0x1 0x0>;
			status = "okay";
		};
	};

	fragment@58 {
		target = <0xffffffff>;

		__overlay__ {
			deb-gpios = <0xffffffff 0x2 0x0>;
			debounce = <0x7d000>;
			interrupt-parent = <0xffffffff>;
			interrupts = <0x2 0x8 0x2 0x0>;
			status = "okay";
		};
	};

	fragment@59 {
		target = <0xffffffff>;

		__overlay__ {
			interrupt-parent = <0xffffffff>;
			interrupts = <0x4 0x4 0x4 0x0>;
			status = "okay";
		};
	};

	fragment@6 {
		target = <0xffffffff>;

		__overlay__ {

			ext_buck_lp4@57 {
				regulator-max-microvolt = <0x13d620>;
				regulator-min-microvolt = <0x493e0>;
				regulator-name = "ext_buck_vdd2";
				vsel_pin = <0x0>;
			};

			ext_buck_lp4x@50 {
				regulator-max-microvolt = <0x13d620>;
				regulator-min-microvolt = <0x493e0>;
				regulator-name = "ext_buck_vddq";
				vsel_pin = <0x1>;
			};
		};
	};

	fragment@60 {
		target = <0xffffffff>;

		__overlay__ {
			interrupt-parent = <0xffffffff>;
			interrupts = <0x5 0x2 0x5 0x0>;
			status = "okay";
		};
	};

	fragment@61 {
		target = <0xffffffff>;

		__overlay__ {
			interrupt-parent = <0xffffffff>;
			interrupts = <0xb 0x2 0xb 0x0>;
			status = "okay";
		};
	};

	fragment@62 {
		target = <0xffffffff>;

		__overlay__ {
			interrupt-parent = <0xffffffff>;
			interrupts = <0x17 0x8 0x17 0x1>;
			status = "okay";
		};
	};

	fragment@63 {
		target = <0xffffffff>;

		__overlay__ {
			interrupt-parent = <0xffffffff>;
			interrupts = <0x29 0x8 0x29 0x0>;
			status = "okay";
		};
	};

	fragment@64 {
		target = <0xffffffff>;

		__overlay__ {
			interrupt-parent = <0xffffffff>;
			interrupts = <0x2c 0x1 0x2c 0x1>;
			status = "okay";
		};
	};

	fragment@65 {
		target = <0xffffffff>;

		__overlay__ {
			deb-gpios = <0xffffffff 0x37 0x0>;
			debounce = <0x7d000>;
			interrupt-parent = <0xffffffff>;
			interrupts = <0x37 0x4 0x37 0x0>;
			status = "okay";
		};
	};

	fragment@66 {
		target = <0xffffffff>;

		__overlay__ {
			interrupt-parent = <0xffffffff>;
			interrupts = <0x90 0x4 0x90 0x1>;
			status = "okay";
		};
	};

	fragment@67 {
		target = <0xffffffff>;

		__overlay__ {
			compatible = "mediatek,md1_sim1_hot_plug_eint-eint";
			debounce = <0x0 0x2710>;
			dedicated = <0x0 0x0>;
			interrupts = <0x0 0x8>;
			sockettype = <0x0 0x0>;
			src_pin = <0x0 0x1>;
			status = "okay";
		};
	};

	fragment@68 {
		target = <0xffffffff>;

		__overlay__ {
			compatible = "mediatek,md1_sim2_hot_plug_eint-eint";
			debounce = <0x1 0x2710>;
			dedicated = <0x1 0x0>;
			interrupts = <0x1 0x8>;
			sockettype = <0x1 0x0>;
			src_pin = <0x1 0x2>;
			status = "okay";
		};
	};

	fragment@69 {
		target = <0xffffffff>;

		__overlay__ {
			regulator-default-on = <0x1>;
			regulator-name = "vcama";
			status = "okay";
		};
	};

	fragment@7 {
		target = <0xffffffff>;

		__overlay__ {

			bq25601@6B {
				charger_name = "primary_chg";
				compatible = "ti,bq25601";
				eint_name = "bq2560x";
				interrupt-parent = <0xffffffff>;
				interrupts = <0xb 0x2 0xb 0x0>;
				pinctrl-0 = <0xa>;
				pinctrl-1 = <0xb>;
				pinctrl-names = "irq_default", "irq_set_low";
				reg = <0x6b>;
				status = "okay";
				ti,bq2560x,boost-current = <0x4b0>;
				ti,bq2560x,boost-voltage = <0x1386>;
				ti,bq2560x,charge-detect-enable;
				ti,bq2560x,enable_term;
				ti,bq2560x,precharge-current = <0x100>;
				ti,bq2560x,stat-pin-ctrl = <0x3>;
				ti,bq2560x,termination-current = <0xf0>;
				ti,bq2560x,usb-ichg = <0x1f4>;
				ti,bq2560x,usb-ilim = <0x1f4>;
				ti,bq2560x,usb-vlim = <0x11f8>;
				ti,bq2560x,usb-vreg = <0x1130>;
				ti,bq2560x,vac-ovp-threshold = <0x1964>;
			};

			rt-swchg@53 {
				compatible = "richtek,swchg";
				reg = <0x53>;
				rt,intr_gpio = <0xffffffff 0xb 0x0>;
				rt,intr_gpio_num = <0xb>;
				status = "okay";

				rt9471 {
					aicr = <0x7a120>;
					charger_name = "primary_chg";
					chg_alias_name = "rt9471_chg";
					cv = <0x426030>;
					en-qon-rst;
					en-te;
					ichg = <0xf4240>;
					ieoc = <0x30d40>;
					interrupt-names = "wdt", "chg_mivr", "vbus_gd", "bc12_done", "detach", "vac_ov", "otg_fault", "chg_rdy", "chg_done";
					mivr = <0x432380>;
					mivr-track = <0x0>;
					rm-name = "rt9471";
					rm-slave-addr = [53];
					safe-tmr = <0xa>;
					wdt = <0x28>;
				};
			};
		};
	};

	fragment@70 {
		target = <0xffffffff>;

		__overlay__ {
			regulator-default-on = <0x1>;
			regulator-name = "vsim1";
			status = "okay";
		};
	};

	fragment@71 {
		target = <0xffffffff>;

		__overlay__ {
			regulator-default-on = <0x1>;
			regulator-name = "vsim2";
			status = "okay";
		};
	};

	fragment@72 {
		target = <0xffffffff>;

		__overlay__ {
			regulator-default-on = <0x1>;
			regulator-name = "vcamd";
			status = "okay";
		};
	};

	fragment@73 {
		target = <0xffffffff>;

		__overlay__ {
			regulator-default-on = <0x1>;
			regulator-name = "vcamio";
			status = "okay";
		};
	};

	fragment@74 {
		target = <0xffffffff>;

		__overlay__ {
			regulator-default-on = <0x1>;
			regulator-name = "vldo28";
			status = "okay";
		};
	};

	fragment@75 {
		target = <0xffffffff>;

		__overlay__ {
			status = "okay";
			vcama-supply = <0xffffffff>;
			vcamaf-supply = <0xffffffff>;
			vcamaf_main2-supply = <0xffffffff>;
			vcamaf_sub-supply = <0xffffffff>;
			vcamd_main2-supply = <0xffffffff>;
			vcamio-supply = <0xffffffff>;
			vcamio_main2-supply = <0xffffffff>;
			vcamio_sub-supply = <0xffffffff>;
		};
	};

	fragment@76 {
		target = <0xffffffff>;

		__overlay__ {
			status = "okay";
			vtouch-supply = <0xffffffff>;
		};
	};

	fragment@77 {
		target = <0xffffffff>;

		__overlay__ {
			mediatek,kpd-hw-dl-key0 = <0x11>;
			mediatek,kpd-hw-dl-key1 = <0x1>;
			mediatek,kpd-hw-init-map = <0x0 0x72 0x0 0x0 0x0 0x0 0x0 0x0 0x0 0x0 0x0 0x0 0x0 0x0 0x0 0x0 0x0 0x0 0x0 0x0 0x0 0x0 0x0 0x0 0x0 0x0 0x0 0x0 0x0 0x0 0x0 0x0 0x0 0x0 0x0 0x0 0x0 0x0 0x0 0x0 0x0 0x0 0x0 0x0 0x0 0x0 0x0 0x0 0x0 0x0 0x0 0x0 0x0 0x0 0x0 0x0 0x0 0x0 0x0 0x0 0x0 0x0 0x0 0x0 0x0 0x0 0x0 0x0 0x0 0x0 0x0 0x0>;
			mediatek,kpd-hw-map-num = <0x48>;
			mediatek,kpd-hw-pwrkey = <0x8>;
			mediatek,kpd-hw-recovery-key = <0x1>;
			mediatek,kpd-hw-rstkey = <0x11>;
			mediatek,kpd-key-debounce = <0x400>;
			mediatek,kpd-pwkey-gpio-din = <0x0>;
			mediatek,kpd-pwrkey-eint-gpio = <0x0>;
			mediatek,kpd-sw-pwrkey = <0x74>;
			mediatek,kpd-sw-rstkey = <0x73>;
			mediatek,kpd-use-extend-type = <0x0>;
			status = "okay";
		};
	};

	fragment@78 {
		target = <0xffffffff>;

		__overlay__ {

			camdefault {
				phandle = <0x37>;
			};

			camera0_mclk_2ma@gpio99 {
				phandle = <0x3f>;

				pins_cmd_dat {
					drive-strength = <0x2>;
					pinmux = <0x6301>;
				};
			};

			camera0_mclk_gpio_mode@gpio99 {
				phandle = <0x3e>;

				pins_cmd_dat {
					drive-strength = <0x1>;
					pinmux = <0x6300>;
				};
			};

			camera0_rst_output_high@gpio101 {
				phandle = <0x39>;

				pins_cmd_dat {
					output-high;
					pinmux = <0x6500>;
				};
			};

			camera0_rst_output_low@gpio101 {
				phandle = <0x38>;

				pins_cmd_dat {
					output-low;
					pinmux = <0x6500>;
				};
			};

			camera0_vcama_off@gpio156 {
				phandle = <0x44>;

				pins_cmd_dat {
					output-low;
					pinmux = <0x9c00>;
				};
			};

			camera0_vcama_on@gpio156 {
				phandle = <0x45>;

				pins_cmd_dat {
					output-high;
					pinmux = <0x9c00>;
				};
			};

			camera1_mclk_2ma@gpio100 {
				phandle = <0x41>;

				pins_cmd_dat {
					drive-strength = <0x2>;
					pinmux = <0x6401>;
				};
			};

			camera1_mclk_gpio_mode@gpio100 {
				phandle = <0x40>;

				pins_cmd_dat {
					drive-strength = <0x1>;
					pinmux = <0x6400>;
				};
			};

			camera1_rst_output_high@gpio102 {
				phandle = <0x3b>;

				pins_cmd_dat {
					output-high;
					pinmux = <0x6600>;
				};
			};

			camera1_rst_output_low@gpio102 {
				phandle = <0x3a>;

				pins_cmd_dat {
					output-low;
					pinmux = <0x6600>;
				};
			};

			camera1_vcama_off@gpio155 {
				phandle = <0x46>;

				pins_cmd_dat {
					output-low;
					pinmux = <0x9b00>;
				};
			};

			camera1_vcama_on@gpio155 {
				phandle = <0x47>;

				pins_cmd_dat {
					output-high;
					pinmux = <0x9b00>;
				};
			};

			camera2_mclk_2ma@gpio108 {
				phandle = <0x43>;

				pins_cmd_dat {
					drive-strength = <0x2>;
					pinmux = <0x6c01>;
				};
			};

			camera2_mclk_gpio_mode@gpio108 {
				phandle = <0x42>;

				pins_cmd_dat {
					drive-strength = <0x1>;
					pinmux = <0x6c00>;
				};
			};

			camera2_pnd_output_high@gpio107 {
				phandle = <0x3d>;

				pins_cmd_dat {
					output-high;
					pinmux = <0x6b00>;
				};
			};

			camera2_pnd_output_low@gpio107 {
				phandle = <0x3c>;

				pins_cmd_dat {
					output-low;
					pinmux = <0x6b00>;
				};
			};

			camera3_mclk_2ma@gpio88 {
				phandle = <0x4d>;

				pins_cmd_dat {
					drive-strength = <0x2>;
					pinmux = <0x5801>;
				};
			};

			camera3_mclk_gpio_mode@gpio88 {
				phandle = <0x4c>;

				pins_cmd_dat {
					drive-strength = <0x1>;
					pinmux = <0x5800>;
				};
			};

			camera3_rst_output_high@gpio160 {
				phandle = <0x4b>;

				pins_cmd_dat {
					output-high;
					pinmux = <0xa000>;
				};
			};

			camera3_rst_output_low@gpio160 {
				phandle = <0x4a>;

				pins_cmd_dat {
					output-low;
					pinmux = <0xa000>;
				};
			};

			camera3_vcama_off@gpio156 {
				phandle = <0x48>;

				pins_cmd_dat {
					output-low;
					pinmux = <0x9c00>;
				};
			};

			camera3_vcama_on@gpio156 {
				phandle = <0x49>;

				pins_cmd_dat {
					output-high;
					pinmux = <0x9c00>;
				};
			};
		};
	};

	fragment@79 {
		target = <0xffffffff>;

		__overlay__ {
			cam0_enable_sensor = "hi846_mipi_raw ov13b10_mipi_raw gc8034_mipi_raw hi1336_mipi_raw s5k4h7_mipi_raw";
			cam0_vcama-supply = <0xffffffff>;
			cam0_vcamaf-supply = <0xffffffff>;
			cam0_vcamd-supply = <0xffffffff>;
			cam0_vcamio-supply = <0xffffffff>;
			cam1_enable_sensor = "hi556_mipi_raw gc5035_mipi_raw hi556_txd_mipi_raw";
			cam1_vcama-supply = <0xffffffff>;
			cam1_vcamd-supply = <0xffffffff>;
			cam1_vcamio-supply = <0xffffffff>;
			cam2_enable_sensor = "gc030a_mipi_raw gc02m1b_mipi_raw ov02b1b_mipi_raw gc02m1b_sw_mipi_raw";
			cam2_vcama-supply = <0xffffffff>;
			cam2_vcamd-supply = <0xffffffff>;
			cam2_vcamio-supply = <0xffffffff>;
			cam3_enable_sensor = "ov02b10_mipi_raw gc02m1_mipi_raw gc02m1_sw_mipi_raw";
			cam3_vcamio-supply = <0xffffffff>;
			pinctrl-0 = <0x37>;
			pinctrl-1 = <0x38>;
			pinctrl-10 = <0x41>;
			pinctrl-11 = <0x42>;
			pinctrl-12 = <0x43>;
			pinctrl-13 = <0x44>;
			pinctrl-14 = <0x45>;
			pinctrl-15 = <0x46>;
			pinctrl-16 = <0x47>;
			pinctrl-17 = <0x48>;
			pinctrl-18 = <0x49>;
			pinctrl-19 = <0x4a>;
			pinctrl-2 = <0x39>;
			pinctrl-20 = <0x4b>;
			pinctrl-21 = <0x4c>;
			pinctrl-22 = <0x4d>;
			pinctrl-3 = <0x3a>;
			pinctrl-4 = <0x3b>;
			pinctrl-5 = <0x3c>;
			pinctrl-6 = <0x3d>;
			pinctrl-7 = <0x3e>;
			pinctrl-8 = <0x3f>;
			pinctrl-9 = <0x40>;
			pinctrl-names = "default", "cam0_rst0", "cam0_rst1", "cam1_rst0", "cam1_rst1", "cam2_pnd0", "cam2_pnd1", "cam0_mclk_off", "cam0_mclk_on", "cam1_mclk_off", "cam1_mclk_on", "cam2_mclk_off", "cam2_mclk_on", "cam0_vcama_off", "cam0_vcama_on", "cam1_vcama_off", "cam1_vcama_on", "cam3_vcama_off", "cam3_vcama_on", "cam3_rst0", "cam3_rst1", "cam3_mclk_off", "cam3_mclk_on";
			status = "okay";
		};
	};

	fragment@8 {
		target = <0xffffffff>;

		__overlay__ {

			irq_default@gpio11 {
				phandle = <0xa>;

				pins_cmd_dat {
					bias-pull-up;
					input-enable;
					pinmux = <0xb00>;
				};
			};

			irq_set_low@gpio11 {
				phandle = <0xb>;

				pins_cmd_dat {
					bias-pull-down;
					input-enable;
					pinmux = <0xb00>;
				};
			};
		};
	};

	fragment@80 {
		target = <0xffffffff>;

		__overlay__ {

			flashlight_pins_default {
				phandle = <0x4e>;

				pins_cmd_dat0 {
					output-low;
					pinmux = <0x600>;
					slew-rate = <0x1>;
				};

				pins_cmd_dat1 {
					output-low;
					pinmux = <0x9d00>;
					slew-rate = <0x1>;
				};
			};

			flashlight_pins_srobe_off {
				phandle = <0x50>;

				pins_cmd_dat {
					output-low;
					pinmux = <0x9d00>;
					slew-rate = <0x1>;
				};
			};

			flashlight_pins_srobe_on {
				phandle = <0x4f>;

				pins_cmd_dat {
					output-high;
					pinmux = <0x9d00>;
					slew-rate = <0x1>;
				};
			};

			flashlight_pins_torch_off {
				phandle = <0x52>;

				pins_cmd_dat {
					output-low;
					pinmux = <0x600>;
					slew-rate = <0x1>;
				};
			};

			flashlight_pins_torch_on {
				phandle = <0x51>;

				pins_cmd_dat {
					output-high;
					pinmux = <0x600>;
					slew-rate = <0x1>;
				};
			};

			flashlight_pins_torch_pwm {
				phandle = <0x53>;

				pins_cmd_dat {
					output-low;
					pinmux = <0x603>;
					slew-rate = <0x1>;
				};
			};
		};
	};

	fragment@81 {
		target = <0xffffffff>;

		__overlay__ {
			pinctrl-0 = <0x4e>;
			pinctrl-1 = <0x4f>;
			pinctrl-2 = <0x50>;
			pinctrl-3 = <0x51>;
			pinctrl-4 = <0x52>;
			pinctrl-5 = <0x53>;
			pinctrl-names = "default", "strobe_on_gpio", "strobe_off_gpio", "torch_on_gpio", "torch_off_gpio", "torch_pwm_gpio";
			status = "okay";
		};
	};

	fragment@9 {
		target = <0xffffffff>;

		__overlay__ {

			ext_buck_vgpu@55 {
				regulator-max-microvolt = <0x13d620>;
				regulator-min-microvolt = <0x493e0>;
				regulator-name = "ext_buck_vgpu";
				vsel_pin = <0x2>;
			};
		};
	};
};
